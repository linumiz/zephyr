## dts/bindings/can/infineon,cat1-can.yaml
```yaml
# Copyright (c) 2025 Linumiz GmbH 
#
# SPDX-License-Identifier: Apache-2.0

description: Infineon Cat1 Family MCAN Driver 

compatible: "infineon,cat1-can"

include: ["bosch,m_can-base.yaml", "pinctrl-device.yaml", "infineon,system-interrupts.yaml"]

properties:
  reg:
    required: true

  clocks:
    required: true

  clock-frequency:
    type: int
    required: true

  ifx,peri-clk:
    type: int
    required: true
    description:
      Clock selection for peripheral

  ifx,peri-group:
    type: int
    required: true
    description:
      Peripheral clock divider group and inst for scb uart

  ifx,peri-div:
    type: int
    required: true
    enum:
      - 0 # 8-bit divider
      - 1 # 16-bit divider
      - 2 # 16_5-bit divider
      - 3 # 24_5-bit divider
    description:
      Peripheral clock divider type.

  ifx,peri-div-inst:
    type: int
    required: true
    description:
      Peripheral clock divider type instance. peripheral clock divider has
      multiple instnace of same type divider, so this property is used to specifi
      which instance to be used. please refer device specific datasheet for
      number of instance present for every divider type.
```

## dts/bindings/charger/mp,mp2733.yaml
```yaml
#Copyright 2025 Linumiz
#SPDX - Licesnse-Identifier: Apache-2.0

description: |
  MP2733 is a single cell switch mode battery charger with OTG support.

compatible: "mp,mp2733"

on-bus: i2c

include: [battery.yaml, i2c-device.yaml]

properties: 
  reg:
    required: true
  
  constant-charge-current-max-microamp:
    type: int
    default: 1840000

  constant-charge-voltage-max-microvolt:
    type: int
    default: 4200000

  precharge-current-microamp: 
    type: int 
    default: 230000

  termcharge-current-microamp:
    type: int
    default: 2000000

  ce-gpios:
    type: phandle-array
    description: Active low, charge enable pin

  int-gpios:
    type: phandle-array
    description: Interrupt pin
  
  otg-gpios:
    type: phandle-array
    description: Active high, otg mode enable pin

  watchdog-timeout-ms:
    type: int
    default: 40000

  min-sys-voltage-microvolt:
    type: int
    default: 3600000

  input-current-limit-microamp:
    type: int
    default: 5000000
    description: |

  input-voltage-limit-microvolt:
    type: int
    default: 4300000

  input-current-dschg-otg-microamp: 
    type: int
    default: 500000

  input-voltage-dschg-otg-microvolt:
    type: int
    default: 5000000

  thermal-regulation-threshold:
    type: int
    default: 3
    enum:
      - 0
      - 1
      - 2 
      - 3
    description: |
      charge control thermal regulation thershold
      0 - 60 degree celsius
      1 - 80 degree celsius
      2 - 100 degree celsius
      3 - 120 degree celsius
```

## dts/bindings/charger/ti,bq2562x.yaml
```yaml
# Copyright 2025 Linumiz
# SPDX-License-Identifier: Apache-2.0

description: |
  BQ25620/BQ25622 is a single cell buck battery charger with OTG support.

  The device has a single child node for the charger. For example:

  bq25620@6b {
    compatible = "ti,bq2562x";
    reg = <0x6b>;

    ce-gpios = <&gpioa 3 GPIO_ACTIVE_LOW>;
    watchdog-timeout-ms = <50000>;
    constant-charge-current-max-microamp = <1040000>;
    constant-charge-voltage-max-microvolt = <4200000>;
    precharge-current-microamp = <100000>;
    charge-term-current-microamp = <60000>;
    input-current-limit-microamp = <1000000>;
    input-voltage-limit-microvolt = <4600000>;
  };

compatible: "ti,bq2562x"

include: [battery.yaml, i2c-device.yaml]

properties:
  constant-charge-current-max-microamp:
    type: int
    default: 1040000

  constant-charge-voltage-max-microvolt:
    type: int
    default: 4200000

  precharge-current-microamp:
    type: int
    default: 100000

  charge-term-current-microamp:
    type: int
    default: 60000

  ce-gpios:
    type: phandle-array
    description: Active low, charge enable pin

  int-gpios:
    type: phandle-array
    description: Interrupt pin

  ti,min-sys-voltage-microvolt:
    type: int
    default: 3520000
    description: |
      Minimum system voltage in micro volts with a 100000 micro volt step.

  ti,input-voltage-limit-microvolt:
    type: int
    default: 4800000
    description: |
      Minimum input voltage limit in micro volts with a 100000 micro volt step.

  ti,input-current-limit-microamp:
    type: int
    default: 4000000
    description: |
      Maximum input current limit in micro amps with a 100000 micro amp step.

  ti,thermal-regulation-threshold:
    type: int
    default: 1
    enum:
      - 0
      - 1
    description: |
      Charger control thermal regulation threshold
      0: 60 degree celsius
      1: 120 degree celsius

  ti,switching-converter-freq:
    type: int
    default: 0
    enum:
      - 0
      - 1
      - 2
    description: |
      Charger step-down converter switching frequency
      0: Nominal, 1.5 MHz
      1: -10%, 1.35 MHz
      2: +10%, 1.65 MHz

  ti,switching-converter-strength:
    type: int
    default: 3
    enum:
      - 0
      - 1
      - 3
    description: |
      Charger step-down converter drive strength for efficiency vs EMI
      0: weak
      1: normal
      3: strong

  ti,q1-fullon:
    type: int
    default: 0
    enum:
      - 0
      - 1
    description: |
      Forces RBFET (Q1) into low resistance state (26 mO) , regardless of IINDPM setting.
      0: RBFET RDSON determined by IINDPM setting
      1: RBFET RDSON is always 26 mO

  ti,q4-fullon:
    type: int
    default: 0
    enum:
      - 0
      - 1
    description: |
      Forces BATFET (Q4) into low resistance state (15 mO), regardless of ICHG setting.
      0: BATFET RDSON determined by charge current
      1: BATFET RDSON is always 15 mO 

  ti,vindpm-bat-track:
    type: int
    default: 0
    enum:
      - 0
      - 1
    description: |
      Sets VINDPM to track BAT voltage. Actual VINDPM is higher of the VINDPM register value and VBAT + VINDPM_BAT_TRACK.
      0: Disable function
      1: VBAT + 400 mV

  ti,verchg-bat-offset:
    type: int
    default: 0
    enum:
      - 0
      - 1
    description: |
      Battery Recharge Threshold Offset.
      0: 100 mV
      1: 200 mV

  ti,enable-dcp-bias:
    type: int
    default: 1
    enum:
      - 0
      - 1
    description: |
      Enable 600 mV bias on D+ pin whenever DCP is detected by BC1.2 detection algorithm.
      0: Disable 600 mV bias on D+ pin
      1: Enable 600 mV bias on D+ pin if DCP detected 

  ti,enable-savety-tmrs:
    type: int
    default: 1
    enum:
      - 0
      - 1
    description: |
      Enable fast charge, pre-charge and trickle charge timers.
      0: Disable 
      1: Enable 

  ti,precharge_timer:
    type: int
    default: 0
    enum:
      - 0
      - 1
    description: |
      Set precharge safety timeout.
      0: 2.5h
      1: 0.62h 

  ti,fast_charge_timer:
    type: int
    default: 0
    enum:
      - 0
      - 1
    description: |
      Set fast charge safety timeout.
      0: 12h
      1: 24h 

  ti,timer2x_en:
    type: int
    default: 1
    enum:
      - 0
      - 1
    description: |
      Allow timeout-doubling in DPM mode or thermal regulation.
      0: Not allowed
      1: allowed

  ti,auto-battery-discharging:
    type: int
    default: 1
    enum:
      - 0
      - 1
    description: |
      Enable the auto battery discharging during the battery OVP fault.
      0: The charger does NOT apply a discharging current on BAT during battery OVP triggered 
      1: The charger does apply a discharging current on BAT during battery OVP triggered 

  ti,vbus-ovp:
    type: int
    default: 1
    enum:
      - 0
      - 1
    description: |
      Sets VBUS overvoltage protection threshold.
      0: 6.3v
      1: 18.5v 

  ti,peak-current-protection-threshold:
    type: int
    default: 3
    enum:
      - 0
      - 1
      - 2
      - 3
    description: |
      Battery discharging peak current protection threshold setting.
      0: 1.5 A
      1: 3 A 
      2: 6 A
      3: 12 A

  ti,charge-rate-stage:
    type: int
    default: 0
    enum:
      - 0
      - 1
      - 2
      - 3
    description: |
      The charge rate definition for the fast charge stage.
      0: 1 C
      1: 2 C 
      2: 4 C
      3: 6 C
```

## dts/bindings/clock/infineon,cat1-clock.yaml
```yaml
# Copyright (c) 2025 Linumiz GmbH 
#
# SPDX-License-Identifier: Apache-2.0

description: Infineon Clock Control Driver  

compatible: "infineon,cat1-clock"

include: [base.yaml, clock-controller.yaml]

properties:
  clock-frequency:
    type: int
    description: output clock frequency (Hz)
    required: true

  clocks:
    description: |
      Clock reference source

  ifx,hf-predivider:
    type: int
    description: Divider for High Frequency Clock 
    required: true

  ifx,hf-instance:
    type: int
    description: High Frequency instance 
    required: true

  "#clock-cells":
    const: 0
```

## dts/bindings/clock/infineon,cat1-fll.yaml
```yaml
# Copyright (c) 2026 Infineon Technologies AG
#
# SPDX-License-Identifier: Apache-2.0

description: Infineon CAT1 FLL Driver

compatible: "infineon,cat1-fll"

include: [base.yaml, clock-controller.yaml]

properties:
  reg:
    required: true

  clock-frequency:
    type: int
    required: true
    description: |
      FLL output frequency in Hz
```
