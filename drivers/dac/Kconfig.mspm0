## drivers/dac/Kconfig.mspm0
```kconfig
# TI MSPM0 DAC Driver Configuration

# Copyright (c) 2025 Linumiz GmbH
# SPDX-License-Identifier: Apache-2.0

config DAC_MSPM0
	bool "TI MSPM0 Digital To Analog Converter (DAC) Driver"
	default y
	depends on DT_HAS_TI_MSPM0_DAC_ENABLED
	select USE_MSPM0_DL_DAC12
	help
	  Enable support for the DAC (Digital-to-Analog Converter)
	  peripheral driver for Texas Instruments MSPM0 G-Series MCUs.

config DAC_MSPM0_DFM_TWOS_COMPLEMENT
	bool "Select two's complement as input data format"
	default n
	depends on DAC_MSPM0
	help
	  Enable two's complement representation for DAC input
	  data. If disabled, binary representation will be used.

config DAC_MSPM0_TIMEOUT_MS
	int "DAC MSPM0 module ready timeout in milliseconds"
	default 50
	help
	  Timeout in milliseconds to wait for the DAC module to be
	  ready after enabling.
```

## drivers/gpio/Kconfig.tc3xx
```kconfig
# Infineon TC4XX GPIO configuration options

# Copyright (c) 2024 Infineon Technologies AG
# SPDX-License-Identifier: Apache-2.0

config GPIO_TC4XX
	bool "Infineon TC4XX GPIO driver"
	default y
	depends on DT_HAS_INFINEON_TC4XX_GPIO_ENABLED
	help
	  Enable Infineon TC4XX GPIO driver.
```

## drivers/gpio/Kconfig.tc4xx
```kconfig
# Infineon TC3XX GPIO configuration options

# Copyright (c) 2024 Infineon Technologies AG
# SPDX-License-Identifier: Apache-2.0

config GPIO_TC3XX
	bool "Infineon TC3XX GPIO driver"
	default y
	depends on DT_HAS_INFINEON_TC3XX_GPIO_ENABLED
	help
	  Enable Infineon TC3XX GPIO driver.
```

## drivers/hwinfo/Kconfig.ifx
```kconfig
# Copyright The Zephyr Project Contributors
# SPDX-License-Identifier: Apache-2.0

config HWINFO_IFX_CAT1
	bool "IFX CAT1 hwinfo"
	default y
	depends on SOC_FAMILY_INFINEON_CAT1C
	select USE_INFINEON_HWINFO
	select HWINFO_HAS_DRIVER
	help
	  Enable IFX CAT1 hwinfo driver
```

## drivers/i2c/Kconfig.mspm0
```kconfig
# SPDX-License-Identifier: Apache-2.0
# Copyright (c) 2024 Texas Instruments
# Copyright (c) 2024 Linumiz

config I2C_MSPM0
	bool "TI I2C MSPM0 driver"
	default y
	depends on DT_HAS_TI_MSPM0_I2C_ENABLED
	select PINCTRL
	help
	  Enable support for I2C on the TI MSPM0 series.
```

## drivers/mfd/Kconfig.bq2562x
```kconfig
# Copyright (c) 2025 Linumiz GmbH
# SPDX-License-Identifier: Apache-2.0

config MFD_BQ2562X
	bool "BQ2562x switch multi-function device driver"
	default y
	depends on DT_HAS_TI_BQ2562X_ENABLED
	select I2C
```

## drivers/modem/Kconfig.simcom-xxxx
```kconfig
# Simcom Modem driver options

# Copyright (C) 2021 metraTec GmbH
# Copyright (C) 2023 Linumiz
# SPDX-License-Identifier: Apache-2.0

menuconfig MODEM_SIMCOM
	bool "Simcom Modem Driver for 7080 series"
	select MODEM_CONTEXT
	select MODEM_CMD_HANDLER
	select MODEM_IFACE_UART
	select MODEM_SOCKET
	select NET_OFFLOAD
	select NET_SOCKETS_OFFLOAD
	imply GPIO
	help
	  Enables the driver for the Simcom modem for 7080 series.

if MODEM_SIMCOM

choice SIMCOM_MODEM_SELECTION
	prompt "Simcom modem selection"
	default MODEM_SIMCOM_SIM7080
	help
	 this helps in selecting simcom modem.

config MODEM_SIMCOM_SIM7080
	bool "simcom sim7080 modem"
	help
	  Enables the driver for the Simcom sim7080 modem.

config MODEM_SIMCOM_Y7080
	bool "simcom Y7080 modem"
	help
	  Enables the driver for the Simcom Y7080 modem.

endchoice

config MODEM_SIMCOM_RX_STACK_SIZE
	int "Stack size for the simcom modem driver rx thread"
	default 2048 if MODEM_SIMCOM_Y7080
	default 1028 if MODEM_SIMCOM_SIM7080
	help
	  This stack is used by the simcom RX thread.

config MODEM_SIMCOM_RX_WORKQ_STACK_SIZE
	int "Stack size for the simcom modem driver work queue"
	default 2048
	help
	 This stack is used by the work queue.

config MODEM_SIMCOM_INIT_PRIORITY
	int "simcom driver init priority"
	default 80
	help
	  Simcom driver initialization priority.

config MODEM_SIMCOM_LTE_BANDS
	string "LTE bands the driver can use"
	default "8,20,28"
	help
	 Comma separated list of usable lte bands.

config MODEM_SIMCOM_PSM_EDRX_DISABLE
	bool "Disable PSM EDRX"
	default n
	help
	 Disable the PSM and EDRX mode.

config MODEM_SIMCOM_APN
	string "APN for establishing a network connection"
	default "internet"
	help
	  This setting is used to set the APN name for the network connection
	  context. This value is specific to the network provider and may
	  need to be changed.

choice MODEM_SIMCOM_RAT
	bool "Radio Access Technology Mode"
	default MODEM_SIMCOM_RAT_NB1

config MODEM_SIMCOM_RAT_NB1
	bool "NB-IoT"
	help
	 Enable LTE NB-IoT mode.

config MODEM_SIMCOM_RAT_M1
	bool "Cat-M1"
	help
	 Enable Cat-M1 mode.

config MODEM_SIMCOM_RAT_GSM
	bool "GSM"
	help
	 Enable GSM mode.

endchoice

choice SIMCOM_GNSS
	bool "SIMCOM GNSS"
	default SIMCOM_GNSS_COLD_START

config SIMCOM_GNSS_WARM_START
	bool "GNSS warm start"
	help
	 Enable gnss warm start mode.

config SIMCOM_GNSS_HOT_START
	bool "GNSS Hot start"
	help
	 Enable gns hot start mode.

config SIMCOM_GNSS_COLD_START
	bool "GNSS cold start"
	help
	 Enable gnss cold start mode.

endchoice

if MODEM_SIMCOM_SIM7080

config MODEM_SIMCOM_FTP_AND_SMS
	bool "FTP and SMS"
	help
	 Enable FTP and SMS support.

endif

endif
```

## drivers/modem/Kconfig.simcom-y7080
```kconfig
# Simcom Y7080 driver options

# Copyright (C) 2023 Linumiz GmbH
# SPDX-License-Identifier: Apache-2.0

config MODEM_SIMCOM_Y7080
	bool "Simcom Y7080 Driver"
	select MODEM_CONTEXT
	select MODEM_CMD_HANDLER
	select MODEM_IFACE_UART
	select MODEM_SOCKET
	select NET_OFFLOAD
	select NET_SOCKETS_OFFLOAD
	imply GPIO
	help
	  Enables the driver for the Y7080 modem.

if MODEM_SIMCOM_Y7080

config MODEM_SIMCOM_Y7080_RX_STACK_SIZE
	int "Stack size for the simcom Y7080 modem driver rx thread"
	default 1028
	help
	  This stack is used by the simcom Y7080 RX thread.

config MODEM_SIMCOM_Y7080_RX_WORKQ_STACK_SIZE
	int "Stack size for the simcom Y7080 modem driver work queue"
	default 2048
	help
		This stack is used by the work queue.

config MODEM_SIMCOM_Y7080_INIT_PRIORITY
	int "simcom Y7080 driver init priority"
	default 80
	help
	  simcom Y7080 driver initialization priority.

config MODEM_SIMCOM_Y7080_LTE_BANDS
	string "LTE bands the driver can use"
	default "3,5,8,20"
	help
		Comma separated list of usable lte bands.

config MODEM_SIMCOM_Y7080_APN
	string "APN for establishing a network connection"
	default "internet"
	help
	  This setting is used to set the APN name for the network connection
	  context. This value is specific to the network provider and may
	  need to be changed.

choice MODEM_SIMCOM_Y7080_GNSS
	bool "Enable GNSS"
	default MODEM_SIMCOM_Y7080_GNSS_COLD_START
	help
	 This helps in enable GNSS in simcom Y7080 module.

config MODEM_SIMCOM_Y7080_GNSS_COLD_START
	bool "Enable cold start"
	help
	 This helps in cold start of GNSS.

config MODEM_SIMCOM_Y7080_GNSS_WARM_START
	bool "Enable warm start"
	help
	 This helps in wam start of GNSS.

config MODEM_SIMCOM_Y7080_GNSS_HOT_START
	bool "Enable hot start"
	help
	 This helps in hot start of GNSS.
endchoice

config SIMCOM_Y7080_GNSS_INFO_TIME
	int "Set time for gnss info"
	range 0 255
	default 20
	help
	 This helps to set the GNSS info time in seconds

endif # MODEM_SIMCOM_Y7080
```

## drivers/pinctrl/Kconfig.aurix
```kconfig
# Copyright (c) 2024 Infineon Technologies AG
# SPDX-License-Identifier: Apache-2.0

config PINCTRL_TC3X
	bool "Infineon TC3x pin controller driver"
	default y
	depends on DT_HAS_INFINEON_TC3XX_PINCTRL_ENABLED
	help
	  Enables Infineon TC3x pin controller driver

config PINCTRL_TC4X
	bool "Infineon TC4x pin controller driver"
	default y
	depends on DT_HAS_INFINEON_TC4XX_PINCTRL_ENABLED
	help
	  Enables Infineon TC4x pin controller driver
```

## drivers/regulator/Kconfig.mp5416
```kconfig
config REGULATOR_MP5416
        bool "MP5416 DC/DC and LDO regulator support"
        default y
        # depends on DT_HAS_MPS_MP5416_ENABLED
        select I2C
        help
          Enable support for the MP5416 PMIC, which includes
          4 buck converters and 4 LDO regulators, controllable over I2C.

if REGULATOR_MP5416

config REGULATOR_MP5416_INIT_PRIORITY
        int "MP5416 regulator driver init priority"
        default 85
        help
          Init priority for the MPS MP5416 regulator driver.
          It must be greater than I2C init priority.

endif # REGULATOR_MP5416
```

## drivers/sensor/bq34110/Kconfig
```kconfig
# Copyright (c) 2020 Linumiz
#
# SPDX-License-Identifier: Apache-2.0

menuconfig BQ34110
	bool "BQ34110 Fuel Gauge"
	depends on I2C
	help
	  Enable I2C-based driver for BQ34110 Fuel Gauge.

if BQ34110

config BQ34110_KNOWN_TEMP
	int "Known temperature in °C"
	default 22
	help
	  Specify the room temperature in °C for Calibration.

config BQ34110_KNOWN_CURRENT
	int "Known load current in mA"
	default 200
	help
	  Specify the applied current in mA for Calibration.

config BQ34110_KNOWN_VOLTAGE
	int "Known Applied voltage in mV"
	default 4200
	help
	  Specify the applied Voltage in mV for Calibration.

choice
	prompt "Trigger mode"
	default BQ34110_TRIGGER_NONE
	help
	  Specify the type of triggering to be used by the driver.

config BQ34110_TRIGGER_NONE
	bool "No trigger"

config BQ34110_TRIGGER_GLOBAL_THREAD
	bool "Use global thread"
	depends on GPIO
	select BQ34110_TRIGGER

config BQ34110_TRIGGER_OWN_THREAD
	bool "Use own thread"
	depends on GPIO
	select BQ34110_TRIGGER

endchoice

config BQ34110_TRIGGER
	bool

config BQ34110_THREAD_PRIORITY
	int "Thread priority"
	depends on BQ34110_TRIGGER_OWN_THREAD
	default 10
	help
	  Priority of thread used by the driver to handle interrupts.

config BQ34110_THREAD_STACK_SIZE
	int "Thread stack size"
	depends on BQ34110_TRIGGER_OWN_THREAD
	default 1024
	help
	  Stack size of thread used by the driver to handle interrupts.

endif # BQ34110
```

## drivers/sensor/cirrus/Kconfig
```kconfig
# Copyright (c) 2024 Linumiz
# SPDX-License-Identifier: Apache-2.0

source "drivers/sensor/cirrus/cs5490/Kconfig"
```

## drivers/sensor/cirrus/cs5490/Kconfig
```kconfig
# Copyright (c) 2024 Linumiz
# SPDX-License-Identifier: Apache-2.0

menuconfig CS5490
	bool "CS5490 Energy Mesaurement Sensor"
	default y
	depends on DT_HAS_CIRRUS_CS5490_ENABLED
	depends on SERIAL && UART_ASYNC_API
	help
	 Enable driver for CS5490 Energy Measurement sensor.

if CS5490

config CS5490_TRIGGER
	bool "Enable CS5490 Trigger"
	depends on GPIO

if CS5490_TRIGGER

config CS5490_TRIGGER_OWN_THREAD
	bool "Use own thread"
	help
	 Enable interrupt handle to run in own thread. By
	 defaults it is in global thread mode(system work queue thread).

config CS5490_THREAD_PRIORITY
	int "CS5490 thread priority"
	depends on CS5490_TRIGGER_OWN_THREAD
	default 10
	help
	 Priority of CS5490 thread to handle interrupt.

config CS5490_THREAD_STACK_SIZE
	int "Thread stack size"
	depends on CS5490_TRIGGER_OWN_THREAD
	default 512
	help
	 Stack size of CS5490 interrupt handling thread.

endif # CS5490_TRIGGER

endif # CS5490
```

## drivers/sensor/htu21d/Kconfig
```kconfig
# HTU21D temperature & humidity sensor configuration option
#
# Copyright (c) 2022 Linumiz
# Author: Arunmani <arunmani@linumiz.com>
#
# SPDX-License-Identifier: Apache-2.0


config HTU21D
	bool "Enable htu21d sensor"
	default y
	depends on DT_HAS_TE_HTU21D_ENABLED
	depends on I2C
	help
	 Enable driver for HTU21D sensor.

if HTU21D

config HTU21D_NH_MASTER
	bool "Allow no hold master mode"
	help
	 To activate no hold master mode
endif
```

## drivers/sensor/st/ais2dw12/Kconfig
```kconfig
# SPDX-License-Identifier: Apache-2.0
#
# Copyright (c) 2024 Linumiz

menuconfig AIS2DW12
	bool "AIS2DW12 acclerometer driver"
	default y
	depends on DT_HAS_ST_AIS2DW12_ENABLED
	select I2C if $(dt_compat_on_bus,$(DT_COMPAT_ST_AIS2DW12),i2c)
	select spi if $(dt_compat_on_bus,$(DT_COMPAT_ST_AIS2DW12),spi)
	help
	 Enable driver for ST AIS2DW12 acclerometer.

if AIS2DW12

config AIS2DW12_TRIGGER
	bool "Trigger mode"

if AIS2DW12_TRIGGER

config AIS2DW12_TRIGGER_OWN_THREAD
	bool "Use own thread"
	help
	 Enable trigger to run in own thread. By
	 default it is global thread mode.

config AIS2DW12_THREAD_PRIORITY
	int "Own thread priority"
	depends on AIS2DW12_TRIGGER_OWN_THREAD
	default 10

config AIS2DW12_THREAD_STACK_SIZE
	int "Own thread stask size"
	depends on AIS2DW12_TRIGGER_OWN_THREAD
	default 1024

endif # AIS2DW12_TRIGGER

config AIS2DW12_ENABLE_TEMP
	bool "Temperature"
	help
	  Enable/disable temperature

endif # AIS2DW12
```

## drivers/spi/Kconfig.mspm0
```kconfig
config SPI_MSPM0
	bool "TI's MSPM0 SPI"
	default y
	select USE_MSPM0_DL_SPI
	select PINCTRL
	help
	 This driver enable TI MSPM0 spi driver.
```

## drivers/timer/Kconfig.tc3xx
```kconfig
# Copyright (c) 2024 Infineon Technologies AG
# SPDX-License-Identifier: Apache-2.0

config TC3XX_STM
	bool "TC3xx System Timer Module (STM) support"
	depends on SOC_SERIES_TC3XX
	default y
	select TICKLESS_CAPABLE
	select TIMER_HAS_64BIT_CYCLE_COUNTER
	select SYSTEM_TIMER_HAS_DISABLE_SUPPORT
	help
	  This option enables the system timer driver for the Infineon TC3xx
	  System Timer Module as seperate modules.
```

## drivers/usb/bc12/Kconfig.bq25620
```kconfig
# Copyright (c) 2025 Linumiz GmbH
# SPDX-License-Identifier: Apache-2.0

config USB_BC12_BQ25620
	bool "TI BQ25620"
	default y
	depends on DT_HAS_TI_BQ25620_BC_ENABLED
	depends on DT_HAS_TI_BQ2562X_ENABLED
	select MFD
	help
	  Enable MFD-based driver for the TI BQ25620 Battery Charger.

config BC12_BQ25620_INIT_PRIORITY
	int "TI BQ25620 driver initialization priority"
	default 90
	depends on USB_BC12_BQ25620
```

## dts/bindings/adc/infineon,ifx-sar.yaml
```yaml
# Copyright (c) 2025 Linumiz GmbH
#
# SPDX-License-Identifier: Apache-2.0

description: |
  Infineon CAT1 SAR driver(cyt4dn) based on pdl
  sample overlay

  / {
        zephyr,user {
                io-channels = <&adc0 20>;
        };
  };

  &adc0 {
        #address-cells = <1>;
        #size-cells = <0>;

        channel@20 {
                reg = <20>;
                zephyr,gain = "ADC_GAIN_1";
                zephyr,reference = "ADC_REF_VDD_1";
                zephyr,input-positive = <15>; /* internal led ADC[0]_15 */
                zephyr,acquisition-time = <ADC_ACQ_TIME(ADC_ACQ_TIME_MICROSECONDS, 10)>;
                zephyr,resolution = <12>;
        };
  };

compatible: "infineon,ifx-sar"

include: [adc-controller.yaml, "infineon,system-interrupts.yaml", pinctrl-device.yaml]

properties:
  reg:
    required: true

  "#io-channel-cells":
    const: 1

  clock-frequency:
    type: int

  ifx,peri-clk:
    type: int

  ifx,peri-group:
    type: int

  ifx,peri-div:
    type: int
    required: true
    enum:
      - 0
      - 1
      - 2
      - 3

  ifx,peri-div-inst:
    type: int
    required: true

io-channel-cells:
  - input
```

## dts/bindings/can/infineon,can.yaml
```yaml
# Copyright (c) 2026 Linumiz
#
# SPDX-License-Identifier: Apache-2.0

description: Infineon MCAN Driver

compatible: "infineon,can"

include: ["bosch,m_can-base.yaml", "pinctrl-device.yaml"]

properties:
  reg:
    required: true

  clocks:
    required: true

  clock-frequency:
    type: int
    required: true
```
