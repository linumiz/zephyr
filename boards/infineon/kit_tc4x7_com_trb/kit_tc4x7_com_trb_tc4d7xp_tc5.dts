/*
 * Copyright (c) 2024 Infineon Technologies AG
 *
 * SPDX-License-Identifier: Apache-2.0
 */

/dts-v1/;

#include "kit_tc4x7_com_trb_tc4d7xp.dtsi"

/ {
	chosen {
		zephyr,flash = &flash5;
		zephyr,sram = &dsram5;
		zephyr,dtcm = &dsram5;
		zephyr,itcm = &psram5;
	};
};