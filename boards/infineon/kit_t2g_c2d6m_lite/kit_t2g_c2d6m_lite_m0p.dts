/*
 * Copyright (c) 2026 Linumiz
 * SPDX-License-Identifier: Apache-2.0
 */

/dts-v1/;
#include <arm/infineon/cat1c/traveo/cyt4dn/cyt4dn_m0p.dtsi>
#include <arm/infineon/cat1c/traveo/cyt4dn/memory_partitions.dtsi>
#include "kit_t2g_c2d6m_lite_common.dtsi"

/ {
	model = "Infineon Evaluation board for CYT4DNJBZS M0+";
	compatible = "infineon,kit_t2g_c2d6m_lite", "infineon,T2G_C2D";

	chosen {
		zephyr,sram = &sram_m0p;
		zephyr,flash = &flash_m0p;
		zephyr,console = &uart9;
		zephyr,shell-uart = &uart9;

	};
};

&uart9 {
	status = "okay";
};

&gpio_prt29 {
        status = "okay";
};
