## boards/infineon/cytvii_b_e_1m_100_cpu/Kconfig.cytvii_b_e_1m_100_cpu
```kconfig
# Copyright (c) 2025 Infineon Technologies AG,
# or an affiliate of Infineon Technologies AG.

# SPDX-License-Identifier: Apache-2.0

config BOARD_CYTVII_B_E_1M_100_CPU_CYT2B75CAE_M0P
	bool
	select SOC_CYT2B75CAE
	select INFINEON_CAT1A_M0PLUS

config BOARD_CYTVII_B_E_1M_100_CPU_CYT2B75CAE_M4
	bool
	select SOC_CYT2B75CAE
	select INFINEON_CAT1A_M4
```

## boards/infineon/cytvii_b_e_1m_100_cpu/cytvii_b_e_1m_100_cpu_cyt2b75cae_m0p_defconfig
```kconfig
# Copyright (c) 2026 Infineon Technologies AG,
# or an affiliate of Infineon Technologies AG.
#
# SPDX-License-Identifier: Apache-2.0

# Code Partition
CONFIG_USE_DT_CODE_PARTITION=y

# Enable clock controller
CONFIG_CLOCK_CONTROL=y

# Enable console
#CONFIG_CONSOLE=y
#CONFIG_UART_CONSOLE=y
# Enable UART driver
#CONFIG_SERIAL=y
# Enable GPIO driver
#CONFIG_GPIO=y
```

## boards/infineon/kit_t2g_b_e_lite/Kconfig.defconfig
```kconfig
# Copyright 2026 Infineon Technologies AG
# SPDX-License-Identifier: Apache-2.0

if BOARD_KIT_T2G_B_E_LITE_CYT2BL5CAE_M0P

config HAS_INFINEON_M0P_LAUNCHER_IMAGE
    bool
    default y

endif
```

## boards/infineon/kit_t2g_b_e_lite/Kconfig.kit_t2g_b_e_lite
```kconfig
# Copyright (c) 2025 Infineon Technologies AG,
# or an affiliate of Infineon Technologies AG.

# SPDX-License-Identifier: Apache-2.0

config BOARD_KIT_T2G_B_E_LITE_CYT2BL5CAE_M0P
	bool
	select SOC_CYT2BL5CAE
	select INFINEON_CAT1A_M0PLUS

config BOARD_KIT_T2G_B_E_LITE_CYT2BL5CAE_M4
	bool
	select SOC_CYT2BL5CAE
	select INFINEON_CAT1A_M4
```

## boards/infineon/kit_t2g_b_e_lite/kit_t2g_b_e_lite_cyt2bl5cae_m4_defconfig
```kconfig
# Copyright (c) 2025 Infineon Technologies AG,
# or an affiliate of Infineon Technologies AG.
#
# SPDX-License-Identifier: Apache-2.0

# Code Partition
CONFIG_USE_DT_CODE_PARTITION=y

# Enable GPIO driver
CONFIG_GPIO=y

# Enable UART driver
CONFIG_SERIAL=y

# Enable console
CONFIG_CONSOLE=y
CONFIG_UART_CONSOLE=y

# Enable clock controller
CONFIG_CLOCK_CONTROL=y

CONFIG_BUILD_OUTPUT_HEX=y
```

## boards/infineon/kit_t2g_c2d6m_lite/kit_t2g_c2d6m_lite_cyt4dnjbzs_m7_0_defconfig
```kconfig
#
# Copyright (c) 2026 Linumiz
# SPDX-License-Identifier: Apache-2.0
#

# General configuration
CONFIG_BUILD_OUTPUT_HEX=y
CONFIG_BUILD_OUTPUT_BIN=y
CONFIG_USE_DT_CODE_PARTITION=y

CONFIG_ARM_MPU=y
CONFIG_HW_STACK_PROTECTION=y
CONFIG_CACHE_MANAGEMENT=n

# Enable console
CONFIG_CONSOLE=y
CONFIG_UART_CONSOLE=y
CONFIG_UART_INFINEON_CAT1_PDL=y

# Enable UART driver
CONFIG_SERIAL=y

# Enable GPIO driver
CONFIG_GPIO=y

# Enable clock controller
CONFIG_CLOCK_CONTROL=y
CONFIG_CLOCK_CONTROL_IFX_TRAVEO=y

CONFIG_NOCACHE_MEMORY=y
CONFIG_INFINEON_TRAVEO_FAMILY=y
```

## drivers/ethernet/cdns_gem/Kconfig
```kconfig
# Cadence GEM Ethernet driver configuration options

# Copyright (c) 2021, Weidmueller Interface GmbH & Co. KG
# Copyright (c) 2026 Linumiz
# SPDX-License-Identifier: Apache-2.0

menu "Cadence GEM Ethernet driver"

config ETH_CDNS_GEM_CORE
	bool
	select NOCACHE_MEMORY if ARCH_HAS_NOCACHE_MEMORY_SUPPORT
	select CACHE_MANAGEMENT if DCACHE
	select NET_CHECKSUM_OFFLOAD_SUPPORTED if NET_L2_ETHERNET
	help
	  This is a driver for the Cadence GEM Ethernet controller IP core.

config ETH_XLNX_GEM
	bool "Xilinx GEM Ethernet driver"
	default y
	depends on DT_HAS_XLNX_GEM_ENABLED
	depends on !QEMU_TARGET || (QEMU_TARGET && NET_QEMU_ETHERNET)
	select ETH_CDNS_GEM_CORE
	help
	  Enable the driver for the Cadence GEM Ethernet controller
	  instances of the Xilinx Zynq-7000 and ZynqMP SoC families.

endmenu
```

## drivers/ethernet/mdio/Kconfig.cdns_gem
```kconfig
# Copyright (c) 2026 Immo Birnbaum
# SPDX-License-Identifier: Apache-2.0

config MDIO_CDNS_GEM
	bool "Cadence GEM MDIO controller driver"
	default y
	depends on DT_HAS_CDNS_GEM_MDIO_ENABLED
	depends on ETH_CDNS_GEM_CORE
	help
	  Enable Cadence GEM MDIO support.

if MDIO_CDNS_GEM

config MDIO_CDNS_GEM_IDLE_TIMEOUT_US
	int "MDIO idle wait timeout"
	default 1000000
	help
	  Timeout in microseconds to wait for the GEM MDIO Bus
	  to become idle before or after a read or write operation.

endif # MDIO_CDNS_GEM
```

## drivers/i2s/Kconfig.ifx_cat1
```kconfig
# Infineon CAT1 I2S configuration options

# Copyright (c) 2025 Infineon Technologies AG,
# or an affiliate of Infineon Technologies AG.
#
# SPDX-License-Identifier: Apache-2.0

config I2S_INFINEON
	bool "Infineon CAT1 I2S driver"
	default y
	depends on DT_HAS_INFINEON_I2S_ENABLED
	select USE_INFINEON_I2S
	select PINCTRL
	help
	  This option enables the I2S driver.

config I2S_INFINEON_CAT1
	bool "Infineon CAT1 AUDIOSS I2S driver"
	default y
	depends on DT_HAS_INFINEON_CAT1_I2S_ENABLED
	select  USE_INFINEON_I2S
	select DMA
	help
	  ISR-driven DMA I2S driver for Infineon TRAVEO T2G AUDIOSS block.
	  Supports I2S and Left-Justified formats, stereo only, 8/16/18/20/24/32-bit.

if I2S_INFINEON || I2S_INFINEON_CAT1

config I2S_INFINEON_RX_QUEUE_SIZE
	int "RX queue length"
	default 8

config I2S_INFINEON_TX_QUEUE_SIZE
	int "TX queue length"
	default 8

endif # I2S_INFINEON
```

## drivers/interrupt_controller/Kconfig.infineon
```kconfig
# Copyright (c) 2026 Linumiz
# SPDX-License-Identifier: Apache-2.0

config INFINEON_INTC_CAT1
	bool "Infineon CAT1 CPUSS system interrupt multiplexer"
	depends on DT_HAS_INFINEON_CAT1_INTC_ENABLED
	depends on SOC_FAMILY_INFINEON_CAT1
	help
	  Infineon CAT1 CPUSS interrupt multiplexer driver. Routes
	  peripheral system interrupts to NVIC lines through a
	  programmable mux.
```

## drivers/timer/Kconfig.ti_mspm0_timer
```kconfig
# Copyright (c) 2026 Linumiz
# SPDX-License-Identifier: Apache-2.0

config TI_MSPM0_SYSTEM_TIMER
	bool "TI MSPM0 System Timer Driver"
	depends on DT_HAS_TI_MSPM0_SYSTEM_TIMER_ENABLED
	select SYSTEM_TIMER_HAS_DISABLE_SUPPORT
	select TICKLESS_CAPABLE
	help
	  This option enables the TI MSPM0 system timer driver.
```

## dts/bindings/clock/infineon,clk-hf.yaml
```yaml
# SPDX-FileCopyrightText: Copyright (c) 2026 Infineon Technologies AG,
# SPDX-FileCopyrightText: or an affiliate of Infineon Technologies AG. All rights reserved.
# SPDX-FileCopyrightText: Copyright (c) 2026 Linumiz
#
# SPDX-License-Identifier: Apache-2.0

title: Infineon SRSS high frequency root clock

description: |
  CLK_HF root. reg is the root number.

  clocks is an FLL or PLL node, or the IMO (MXS22SRSS: IHO) node to
  use the direct mux. An okay root is configured at init and is not
  changed afterwards.

  clock-div is 1, 2, 4 or 8 on MXS40SRSS and 1 to 16 on MXS40SSRSS and
  MXS22SRSS.

compatible: "infineon,clk-hf"

include: [base.yaml, fixed-factor-clock.yaml]

properties:
  reg:
    required: true

  clocks:
    required: true

  infineon,max-frequency:
    type: int
    description: Datasheet limit in Hz, checked at build time.
```

## dts/bindings/clock/infineon,clk-osc.yaml
```yaml
# SPDX-FileCopyrightText: Copyright (c) 2026 Linumiz
#
# SPDX-License-Identifier: Apache-2.0

title: Infineon SRSS oscillator

description: |
  Clock source of the SRSS path muxes. reg is the CLK_PATH_SELECT
  source code of the oscillator; codes 0x100 and up select the DSI
  mux.

    code   MXS40SRSS  MXS40SSRSS  MXS22SRSS
    0      IMO        IMO         IHO
    1      EXT        EXT         EXT
    2      ECO        ECO         ECO
    3      -          -           IMO
    5      LPECO      -           -
    6      -          IHO         -
    0x110  ILO0       ILO         -
    0x111  WCO        WCO         WCO
    0x113  -          -           PILO
    0x114  ILO1       -           -

  IMO and IHO always run. An okay ECO is enabled at init with trims
  calculated from the eco-* properties. The ECO node is named eco@2.

  An okay ILO, PILO or WCO that is not running is enabled at init. A
  PILO enabled at init is waited on until PILO_OK. The WCO is waited on
  until WCO_OK only when a pll uses it as input; otherwise get_rate
  reports 0 until WCO_OK is set. ILO and PILO reset enabled, and their
  enable bits are write protected by WDT_LOCK.

compatible: "infineon,clk-osc"

include: fixed-clock.yaml

properties:
  reg:
    required: true

  eco-load-capacitance-pf:
    type: int
    description: ECO only. Crystal load capacitance in picofarads.

  eco-esr-ohms:
    type: int
    description: ECO only. Crystal equivalent series resistance in ohms.

  eco-drive-level-uw:
    type: int
    description: ECO only. Crystal maximum drive level in microwatts.
```

## dts/bindings/clock/infineon,clk-pll.yaml
```yaml
# SPDX-FileCopyrightText: Copyright (c) 2026 Linumiz
# SPDX-FileCopyrightText: Copyright (c) 2026 Infineon Technologies AG,
# SPDX-FileCopyrightText: or an affiliate of Infineon Technologies AG. All rights reserved.
#
# SPDX-License-Identifier: Apache-2.0

title: Infineon SRSS FLL and PLL

description: |
  FLL or PLL on a clock path. reg is the clock path number.

  output = input * (feedback-div + fraction-div / 2^F) /
           (reference-div * output-div)

    type     feedback  reference  output  F   VCO / DCO (MHz)
    pll400m  16-200    1-16       2-16    24  400-800
    pll200m  22-112    1-18       2-16    -   200-400
    dpll-lp  16-200    1-16       1-16    24  PFD 4-8 MHz
    dpll-hp  8-250     1-8        2-8     21  DCO 400-1000, PFD 17-50 MHz
    fll      calculated from clock-frequency, output divider fixed to 2

  An okay PLL is programmed at init with feedback-div, reference-div
  and output-div and is not changed afterwards. The FLL is configured
  from clock-frequency.

compatible: "infineon,clk-pll"

include: [clock-controller.yaml, base.yaml]

properties:
  reg:
    required: true

  clocks:
    required: true
    description: Input oscillator.

  "#clock-cells":
    const: 0

  infineon,pll-type:
    type: string
    required: true
    enum:
      - "fll"
      - "pll200m"
      - "pll400m"
      - "dpll-lp"
      - "dpll-hp"
    description: Hardware type of the PLL.

  clock-frequency:
    type: int
    description: |
      Output frequency in Hz. Required for the FLL. For a PLL it is
      optional and must equal the integer part of the frequency given
      by the dividers.

  feedback-div:
    type: int
    description: Feedback divider.

  reference-div:
    type: int
    description: Reference divider.

  output-div:
    type: int
    description: Output divider.

  fraction-div:
    type: int
    description: |
      Fractional part of the feedback divider in units of 1/2^F.
      Enables fractional mode.
```

## dts/bindings/clock/infineon,clk-srss.yaml
```yaml
# SPDX-FileCopyrightText: Copyright (c) 2026 Infineon Technologies AG,
# SPDX-FileCopyrightText: or an affiliate of Infineon Technologies AG. All rights reserved.
# SPDX-FileCopyrightText: Copyright (c) 2026 Linumiz
#
# SPDX-License-Identifier: Apache-2.0
title: Infineon SRSS clock controller

description: |
  SRSS clock block. One clock_control device for the oscillators,
  PLLs, paths and CLK_HF roots below it. The SRSS generation
  (MXS40SRSS, MXS40SSRSS, MXS22SRSS) is selected by the SoC Kconfig.

  Child nodes:
    oscillators: infineon,clk-osc, reg is the CLK_PATH_SELECT code.
    pll:         infineon,clk-pll, reg is the clock path number.
    rootclocks:  infineon,clk-hf, reg is the CLK_HF root number.

  The clocks are configured at init from the devicetree and are not
  changed afterwards. Only get_rate is supported; it reads the
  hardware.

compatible: "infineon,clk-srss"

include: base.yaml

properties:
  reg:
    required: true
```

## dts/bindings/counter/infineon,tcpwm-counter.yaml
```yaml
# Copyright (c) 2025 Infineon Technologies AG,
# or an affiliate of Infineon Technologies AG.
#
# SPDX-License-Identifier: Apache-2.0

description: Infineon counter

compatible: "infineon,tcpwm-counter"

include: [base.yaml, "infineon,system-interrupts.yaml"]

properties:
  external-trigger-gpios:
    type: phandle-array
    description: |
      External trigger that runs counter

  interrupts:
    description: Required for non-cat1c devices

  system-interrupts:
    description: Required for cat1c devices
  
  divider-type:
    type: int
    description: |
      Specifies which type of divider to use.
      Defined by cy_en_divider_types_t in cy_sysclk.h.

  divider-sel:
    type: int
    description: |
      Specifies which divider of the selected type to configure.

  divider-val:
    type: int
    description: |
      Causes integer division of (divider value + 1), or division by 1 to 256
      (8-bit divider) or 1 to 65536 (16-bit divider).
```

## dts/bindings/ethernet/mdio/cdns,gem-mdio.yaml
```yaml
# Copyright (c) 2026 Immo Birnbaum
# SPDX-License-Identifier: Apache-2.0

description: Cadence GEM MDIO node

compatible: "cdns,gem-mdio"

include: [mdio-controller.yaml, pinctrl-device.yaml]
```

## dts/bindings/ethernet/xlnx,gem.yaml
```yaml
#
# Copyright (c) 2021, Weidmueller Interface GmbH & Co. KG
# SPDX-License-Identifier: Apache-2.0
#

description: Xilinx GEM Ethernet controller

compatible: "xlnx,gem"

include: cdns,gem-common.yaml

properties:
  clock-frequency:
    type: int
    required: true
    description: |
      Specifies the base clock frequency from which the GEM's TX clock
      frequency will be derived using two dividers in the respective GEM's
      clock control register in the CRL_APB. The GEM's TX clock frequency
      is determined by the current link speed reported by the PHY, to
      which it will be adjusted at run-time. Therefore, the value of this
      item must be set to the clock frequency of the PLL supplying the
      respective GEM's TX clock - by default, this is the IO PLL.
```

## dts/bindings/i2s/infineon,cat1-i2s.yaml
```yaml
# Copyright (c) 2026 Linumiz
# SPDX-License-Identifier: Apache-2.0

description: Infineon CAT1 AUDIOSS I2S controller

compatible: "infineon,cat1-i2s"

include: [base.yaml, pinctrl-device.yaml, "infineon,system-interrupts.yaml"]

properties:
  reg:
    required: true

  system-interrupts:
    required: true

  dmas:
    required: true

  dma-names:
    required: true

  pinctrl-0:
    required: true

  pinctrl-names:
    required: true
```

## dts/bindings/interrupt-controller/infineon,cat1-intc.yaml
```yaml
# Copyright (c) 2026 Linumiz
# SPDX-License-Identifier: Apache-2.0

description: |
  Infineon TRAVEO T2G (CAT1) system interrupt multiplexer.

  The CAT1 CPUSS routes hundreds of peripheral system interrupts onto
  a limited set of NVIC IRQ lines through a programmable multiplexer.
  CM0+ has 8 mux outputs (NvicMux0-7), CM7 has 16 (NvicMux0-15).

  Each system interrupt has a SYSTEM_INT_CTL register containing a
  CPU_INT_IDX field (selects which NVIC line) and a CPU_INT_VALID bit
  (enables routing). Multiple system interrupts can map to the same
  NVIC line; the hardware resolves by reporting the lowest-indexed
  active source in the corresponding INTx_STATUS register.

  The ISR reads SYSTEM_INT_IDX from INTx_STATUS to identify which
  peripheral triggered the interrupt, then dispatches accordingly.

  CM7 cores additionally have 8 direct internal IRQs (Internal0-7)
  that bypass the mux entirely.

compatible: "infineon,cat1-intc"

include: [interrupt-controller.yaml, base.yaml]

properties:
  "#interrupt-cells":
    const: 2
```
