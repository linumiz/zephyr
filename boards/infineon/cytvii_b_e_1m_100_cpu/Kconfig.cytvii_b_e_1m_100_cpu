## dts/bindings/misc/infineon,tcpwm-tgpio.yaml
```yaml
# Copyright (c) 2026 Linumiz
# SPDX-License-Identifier: Apache-2.0

description: Infineon tgpio

compatible: "infineon,tcpwm-tgpio"

include: base.yaml

properties:
  ifx,peri-group:
    type: int
    description: Peripheral clock group index (CAT1C only).

  divider-type:
    type: int
    required: true

  divider-sel:
    type: int
    required: true

  divider-val:
    type: int
    required: true

child-binding:
  description: TGPIO channel configuration.

  include: pinctrl-device.yaml 
  properties:
    reg:
      type: array
      required: true
      description: Channel index within the TCPWM group.

    system-interrupts:
      type: array
      required: true
      description: System interrupt number and priority

    pinctrl-0:
      required: true

    pinctrl-names:
      required: true
```

## dts/bindings/mtd/infineon,ifx-hyperbus-flash.yaml
```yaml
# Copyright (c) 2026, Linumiz
# SPDX-License-Identifier: Apache-2.0

description: Infineon Hyperbus flash modules

compatible: "infineon-ifx-hyperbus-flash"

include: soc-nv-flash.yaml

properties:
  chip-select:
    type: int
    description: The chip select of the HyperFlash/HyperRAM node
```

## dts/bindings/mtd/infineon,ifx-qspi-nor-flash.yaml
```yaml
# Copyright (c) 2026, Linumiz
# SPDX-License-Identifier: Apache-2.0

description: Infineon Hyperbus flash modules

compatible: "infineon-ifx-qspi-nor-flash"

include: soc-nv-flash.yaml

properties:
  chip-select:
    type: int
    description: The chip select of the HyperFlash/HyperRAM node
```

## dts/bindings/pwm/infineon,cat1-pwm.yaml
```yaml
# Copyright (c) 2026 Linumiz 
# SPDX-License-Identifier: Apache-2.0

description: |
  Infineon CAT1 TCPWM PWM controller.
  One instance per TCPWM group (GRP0/GRP1/GRP2).
  Each child node represents a PWM channel within the group.

compatible: "infineon,cat1-pwm"

include: [pwm-controller.yaml, base.yaml]

properties:
  reg:
    required: true

  "#pwm-cells":
    const: 3

  resolution:
    type: int
    required: true
    enum: [16, 32]
    description: Counter resolution in bits for this TCPWM group.

  ifx,peri-group:
    type: int
    description: Peripheral clock group index (CAT1C only).

pwm-cells:
  - channel
  - period
  - flags

child-binding:
  description: PWM channel configuration.

  include: pinctrl-device.yaml

  properties:
    reg:
      type: array
      required: true
      description: Channel index within the TCPWM group.

    divider-type:
      type: int
      required: true
      description: Clock divider type (cy_en_divider_types_t).

    divider-sel:
      type: int
      required: true
      description: Clock divider instance selector.

    divider-val:
      type: int
      required: true
      description: Clock divider value.
    
    pinctrl-0:
      required: true

    pinctrl-names:
      required: true

    system-interrupts:
      type: array
      description: System interrupt number and priority.
```
