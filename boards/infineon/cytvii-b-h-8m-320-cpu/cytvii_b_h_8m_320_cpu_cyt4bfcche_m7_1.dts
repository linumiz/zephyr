/*
 * Copyright (c) 2025 Infineon Technologies AG,
 * or an affiliate of Infineon Technologies AG.
 *
 * SPDX-License-Identifier: Apache-2.0
 */

/dts-v1/;
#include <arm/infineon/cat1c/traveo2-8m/cyt4bfcche.dtsi>
#include <arm/infineon/cat1c/traveo2-8m/system_clocks.dtsi>
#include <arm/infineon/cat1c/traveo2-8m/cyt4bf_m7.dtsi>
#include "cytvii_b_h_8m_320_cpu_common.dtsi"
#include "cytvii_b_h_8m_320_cpu_cyt4bfcche_m0p_pinctrl.dtsi"

/ {
	model = "Infineon Evaluation Evk board for CYT4BFCCHE M7_1";
	compatible = "infineon,cytvii-b-h-8m-320-cpu", "infineon,CYTVIIBH8M";

	chosen {
		zephyr,sram = &sram_m7_1;
		zephyr,flash = &code_flash0;
		zephyr,dtcm = &dtcm;
		zephyr,itcm = &itcm;
		zephyr,code-partition = &m7_1_partition;
		zephyr,console = &uart3;
		zephyr,shell-uart = &uart3;
	};
};

&m7_1 {
	status = "okay";
};

&uart3 {
	status = "okay";
};