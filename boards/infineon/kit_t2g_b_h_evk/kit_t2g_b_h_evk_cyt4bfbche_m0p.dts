/*
 * Copyright (c) 2025 Infineon Technologies AG,
 * or an affiliate of Infineon Technologies AG.
 *
 * SPDX-License-Identifier: Apache-2.0
 */

/dts-v1/;
#include <arm/infineon/cat1c/traveo2-8m/cyt4bfbche.dtsi>
#include <arm/infineon/cat1c/traveo2-8m/system_clocks.dtsi>
#include <arm/infineon/cat1c/traveo2-8m/cyt4bf_m0p.dtsi>
#include "kit_t2g_b_h_evk_cyt4bfbche_m0p-pinctrl.dtsi"
#include "kit_t2g_b_h_evk_common.dtsi"

/ {
	model = "Infineon Evaluation board for CYT4BFBCHE M0";
	compatible = "infineon,kit_t2g_b_h_evk", "infineon,TVIIBH8M";

	chosen {
        zephyr,sram = &sram_m0plus;
        zephyr,flash = &code_flash0;
        zephyr,code-partition = &m0p_partition;
        zephyr,console = &uart3;
        zephyr,shell-uart = &uart3;
	};
};

&uart3 {
	status = "okay";
};