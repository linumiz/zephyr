## soc/infineon/cat1c/Kconfig.defconfig
```kconfig
# CAT1C Configuration

# Copyright (c) 2024 Cypress Semiconductor Corporation.
# SPDX-License-Identifier: Apache-2.0

if SOC_FAMILY_INFINEON_CAT1C

config GEN_IRQ_VECTOR_TABLE
	default n

config DYNAMIC_INTERRUPTS
    default y

config BUILD_OUTPUT_HEX
	default y

rsource "*/Kconfig.defconfig"

endif # SOC_FAMILY_INFINEON_CAT1C
```

## soc/infineon/cat1c/Kconfig.sysbuild
```kconfig
# Copyright (c) 2025 Infineon Technologies AG
# SPDX-License-Identifier: Apache-2.0

config HAS_INFINEON_M0P_LAUNCHER_IMAGE
	bool

rsource "common/m0p/Kconfig.sysbuild"
orsource "*/Kconfig.sysbuild"
```

## soc/infineon/cat1c/common/Kconfig.defconfig
```kconfig
# Copyright (c) 2025 Infineon Technologies AG
# SPDX-License-Identifier: Apache-2.0

if INFINEON_CAT1C_M0PLUS
config SYS_CLOCK_HW_CYCLES_PER_SEC
	default $(dt_node_int_prop_int,/cpus/cpu@0,clock-frequency)
endif

if INFINEON_CAT1C_M7_0
config SYS_CLOCK_HW_CYCLES_PER_SEC
	default $(dt_node_int_prop_int,/cpus/cpu@1,clock-frequency)
endif

if INFINEON_CAT1C_M7_1
config SYS_CLOCK_HW_CYCLES_PER_SEC
	default $(dt_node_int_prop_int,/cpus/cpu@2,clock-frequency)
endif
```

## soc/infineon/cat1c/common/m0p/Kconfig
```kconfig
# Copyright (c) 2025 Infineon Technolgies AG
# SPDX-License-Identifier: Apache-2.0

config INFINEON_CAT1C_M0PLUS
	bool
	select ARM
	select CPU_CORTEX_M0PLUS
	select CPU_CORTEX_M_HAS_SYSTICK
	select CPU_HAS_ARM_MPU
	select CPU_CORTEX_M_HAS_VTOR
	select ARM_CUSTOM_INTERRUPT_CONTROLLER
	select SOC_PREP_HOOK

config INFINEON_CAT1C_START_M7_0
	bool "Infineon M7 Core 0 during M0+ startup"
	default y
	help
	  Enable starting M7 core 0 from M0+ core.

config INFINEON_CAT1C_START_M7_1
	bool "Infineon M7 Core 1 during M0+ startup"
	default y
	help
	  Enable starting M7 core 1 from M0+ core.1
```

## soc/infineon/cat1c/common/m7/Kconfig
```kconfig
config INFINEON_CAT1C_M7
    bool
	select ARM
    select CPU_CORTEX_M7 
	select CPU_CORTEX_M_HAS_SYSTICK
	select CPU_CORTEX_M_HAS_VTOR
	select CPU_HAS_ARM_MPU
	select CPU_HAS_ICACHE 
	select CPU_HAS_DCACHE
	select CPU_HAS_FPU
    select ARM_CUSTOM_INTERRUPT_CONTROLLER
	select SOC_PREP_HOOK
	select SOC_EARLY_INIT_HOOK

config INFINEON_CAT1C_M7_0
    select INFINEON_CAT1C_M7

config INFINEON_CAT1C_M7_1
    select INFINEON_CAT1C_M7
```

## soc/infineon/cat1c/cyt4bf/Kconfig.defconfig
```kconfig
# Copyright (c) 2026 Infineon Technologies AG
# SPDX-License-Identifier: Apache-2.0

# Infineon CAT1C based MCU default configuration

if SOC_SERIES_CYT4BF

# Cortex-M7 has additional 8 software irqs directly connected to IRQ lines
config NUM_IRQS
	default 566 if INFINEON_CAT1C_M0PLUS
	default 574 if INFINEON_CAT1C_M7

choice INFINEON_CAT1C_CORE
	default INFINEON_CAT1C_M0PLUS if SOC_CYT4BF8CDS_M0PLUS || SOC_CYT4BFCCHE_M0PLUS || SOC_CYT4BFBCHE_M0PLUS
	default INFINEON_CAT1C_M7_0 if SOC_CYT4BF8CDS_M7_0 || SOC_CYT4BFCCHE_M7_0 || SOC_CYT4BFBCHE_M7_0
	default INFINEON_CAT1C_M7_1 if SOC_CYT4BF8CDS_M7_1 || SOC_CYT4BFCCHE_M7_1 || SOC_CYT4BFBCHE_M7_1
endchoice

endif # SOC_SERIES_CYT4BF
```

## soc/infineon/cat1c/cyt4bf/Kconfig.soc
```kconfig
# Copyright (c) 2025 Linumiz GmbH
# SPDX-License-Identifier: Apache-2.0

# SOC series
config SOC_SERIES_CYT4BF
	bool
	select SOC_FAMILY_INFINEON_CAT1C

config SOC_SERIES
	default "cyt4bf" if SOC_SERIES_CYT4BF

config SOC_DIE_CYT4BF
	bool
	select SOC_SERIES_CYT4BF

config SOC_CYT4BF8CDS_M0PLUS
	bool
	select SOC_DIE_CYT4BF

config SOC_CYT4BF8CDS_M7_0
	bool
	select SOC_DIE_CYT4BF

config SOC_CYT4BF8CDS_M7_1
	bool
	select SOC_DIE_CYT4BF

config SOC_CYT4BFCCHE_M0PLUS
	bool
	select SOC_DIE_CYT4BF

config SOC_CYT4BFCCHE_M7_0
	bool
	select SOC_DIE_CYT4BF

config SOC_CYT4BFCCHE_M7_1
	bool
	select SOC_DIE_CYT4BF

config SOC_CYT4BFBCHE_M0PLUS
	bool
	select SOC_DIE_CYT4BF

config SOC_CYT4BFBCHE_M7_0
	bool
	select SOC_DIE_CYT4BF

config SOC_CYT4BFBCHE_M7_1
	bool
	select SOC_DIE_CYT4BF



config SOC
	default "cyt4bf8cds" if SOC_CYT4BF8CDS_M0PLUS || SOC_CYT4BF8CDS_M7_0 || SOC_CYT4BF8CDS_M7_1
	default "cyt4bfcche" if SOC_CYT4BFCCHE_M0PLUS || SOC_CYT4BFCCHE_M7_0 || SOC_CYT4BFCCHE_M7_1
	default "cyt4bfbche" if SOC_CYT4BFBCHE_M0PLUS || SOC_CYT4BFBCHE_M7_0 || SOC_CYT4BFBCHE_M7_1
```

## soc/infineon/cat1c/cyt4bf/Kconfig.sysbuild
```kconfig
if SOC_SERIES_CYT4BF

config HAS_INFINEON_M0P_LAUNCHER_IMAGE
    default y

endif
```

## soc/infineon/cat1c/cyt4dn/Kconfig
```kconfig
# Copyright (c) 2025 Linumiz GmbH
# SPDX-License-Identifier: Apache-2.0

config SOC_SERIES_CYT4DN
	select ARM
	select CPU_CORTEX_M_HAS_SYSTICK
	select CPU_HAS_ARM_MPU
	select CPU_CORTEX_M_HAS_VTOR
	select CPU_HAS_ICACHE if CPU_CORTEX_M7
	select CPU_HAS_DCACHE if CPU_CORTEX_M7
	select CPU_HAS_FPU if CPU_CORTEX_M7
	select SOC_PREP_HOOK

config SOC_CYT4DNJBZS_M0PLUS
	select CPU_CORTEX_M0PLUS

config SOC_CYT4DNJBZS_M7_0 
	select CPU_CORTEX_M7 
	select SOC_EARLY_INIT_HOOK

config SOC_CYT4DNJBZS_M7_1 
	select CPU_CORTEX_M7 
	select SOC_EARLY_INIT_HOOK

config SOC_CYT4DNJBZS_M7_SMP
	select CPU_CORTEX_M7
	select SOC_EARLY_INIT_HOOK
```

## soc/infineon/cat1c/cyt4dn/Kconfig.soc
```kconfig
# Copyright (c) 2025 Linumiz GmbH
# SPDX-License-Identifier: Apache-2.0

# SOC series
config SOC_SERIES_CYT4DN
	bool
	select SOC_FAMILY_INFINEON_CAT1C

config SOC_SERIES
	default "cyt4dn" if SOC_SERIES_CYT4DN

config SOC_DIE_CYT4DN
	bool
	select SOC_SERIES_CYT4DN

config SOC_CYT4DNJBZS_M0PLUS 
	bool
	select SOC_DIE_CYT4DN

config SOC_CYT4DNJBZS_M7_0 
	bool
	select SOC_DIE_CYT4DN

config SOC_CYT4DNJBZS_M7_1 
	bool
	select SOC_DIE_CYT4DN

config SOC
	default "cyt4dnjbzs" if SOC_CYT4DNJBZS_M0PLUS || SOC_CYT4DNJBZS_M7_0 || SOC_CYT4DNJBZS_M7_1
```

## soc/infineon/cat1c/cyt4dn/Kconfig.sysbuild
```kconfig
if SOC_SERIES_CYT4DN

config HAS_INFINEON_M0P_LAUNCHER_IMAGE
    default y

endif
```

## soc/infineon/cat1c/cyt4dn/m0p/Kconfig.sysbuild
```kconfig
# Copyright (c) 2025 Infineon Technologies AG
# SPDX-License-Identifier: Apache-2.0

config M0P_LAUNCHER
	bool "M0P launcher"
	default y
	depends on HAS_INFINEON_M0P_LAUNCHER_IMAGE
	help
	  Include M0P launcher in build.
	  M0P launcher is a minimal sample built for an ARM core that starts given core.
	  It is based on samples/basic/minimal with an appropriate snippet.
```

## soc/ti/mspm0/mspm0c110x/Kconfig
```kconfig
# TI MSPM0C110X

# Copyright (c) 2025 Linumiz
# SPDX-License-Identifier: Apache-2.0

config SOC_SERIES_MSPM0C110X
	select ARM
	select CPU_CORTEX_M0PLUS
	select CPU_CORTEX_M_HAS_VTOR
	select CPU_HAS_ARM_MPU
	select BUILD_OUTPUT_BIN
	select BUILD_OUTPUT_HEX
	select HAS_MSPM0_SDK
	help
	  Enable support for TI MSPM0C110X.
```

## soc/ti/mspm0/mspm0c110x/Kconfig.defconfig
```kconfig
# TI MSPM0C110X

# Copyright (c) 2025 Linumiz
# SPDX-License-Identifier: Apache-2.0


DT_MSPM0_CLKMUX_PATH := $(dt_nodelabel_path,clkmux)
DT_MSPM0_CLKMUX_CPU_FREQ := $(dt_node_int_prop_int,$(DT_MSPM0_CLKMUX_PATH),clock-frequency)

if SOC_SERIES_MSPM0C110X

config SYS_CLOCK_HW_CYCLES_PER_SEC
	default "$(DT_MSPM0_CLKMUX_CPU_FREQ)" if "$(dt_nodelabel_enabled,clkmux)"

rsource "Kconfig.defconfig.mspm0c1104"

endif # SOC_SERIES_MSPM0C110X
```

## soc/ti/mspm0/mspm0c110x/Kconfig.defconfig.mspm0c1104
```kconfig
# TI MSPM0C1104 SoC

# Copyright (c) 2025 Linumiz
# SPDX-License-Identifier: Apache-2.0

if SOC_MSPM0C1104

config SOC
	default "mspm0c1104"

config NUM_IRQS
	default 32

endif # SOC_MSPM0C1104
```

## soc/ti/mspm0/mspm0c110x/Kconfig.soc
```kconfig
# Copyright (c) 2025 Linumiz
# SPDX-License-Identifier: Apache-2.0

config SOC_SERIES_MSPM0C110X
	bool
	select SOC_FAMILY_TI_MSPM0
	help
	 Enable support for TI MSPM0C110X SoC Series.

config SOC_MSPM0C1104
	bool
	select SOC_SERIES_MSPM0C110X

config SOC_SERIES
	default "mspm0c110x" if SOC_SERIES_MSPM0C110X

config SOC
	default "mspm0c1104" if SOC_MSPM0C1104
```
