## arch/tricore/Kconfig
```kconfig
# Copyright (c) 2024 Infineon Technologies AG
# SPDX-License-Identifier: Apache-2.0

menu "Tricore Options"
	depends on TRICORE

config ARCH
	string
	default "tricore"

config CPU_TC162
	select ARCH_HAS_NOCACHE_MEMORY_SUPPORT
	select CPU_HAS_DCACHE
	select CPU_HAS_ICACHE
	select CPU_CACHE_INCOHERENT
	imply FPU
	bool

config CPU_TC18
	select ARCH_HAS_NOCACHE_MEMORY_SUPPORT
	select CPU_HAS_DCACHE
	select CPU_HAS_ICACHE
	select CPU_CACHE_INCOHERENT
	imply FPU
	bool

config TRICORE_CSA_COUNT
	int "Number of Context Save Areas allocated"
	default 256

config TRICORE_CORE_ID
	int "Core ID of the core if running in AMP mode"
	default 0
	help
		Core ID of the TriCore core

config TRICORE_RESET_TRAMPOLINE
	bool "Enable trampoline to jump to cached address"
	default y
	help
		Enable startup trampoline function which jumps from
		any address (e.g. no cached) to the actual startup
		function.

menu "Tricore Processor Options"

config TRICORE_MPU
	bool "Tricore MPU Support"
	select THREAD_STACK_INFO
	select CPU_HAS_MPU
	select MPU
	select MPU_REQUIRES_POWER_OF_TWO_ALIGNMENT
	select ARCH_HAS_USERSPACE
	select ARCH_HAS_STACK_PROTECTION
	select ARCH_MEM_DOMAIN_SUPPORTS_ISOLATED_STACKS
#	select ARCH_MEM_DOMAIN_SYNCHRONOUS_API if USERSPACE
	select ARCH_MEM_DOMAIN_DATA if USERSPACE
	select SRAM_REGION_PERMISSIONS
#	select THREAD_LOCAL_STORAGE if USERSPACE
	help
	  Tricore implements Memory Protection Unit.

if TRICORE_MPU
config TRICORE_MPU_CODE_REGIONS
	int "Number of MPU code regions"
	default 8
	help
	  Number of code regions supported by the MPU.

config TRICORE_MPU_DATA_REGIONS
	int "Number of MPU data regions"
	default 16
	help
	  Number of data regions supported by the MPU.

config TRICORE_MPU_PROTECTION_SETS
	int "Number of MPU protection sets"
	default 4
	help
	  Number of protection sets supported by the MPU.
endif # TRICORE_MPU

config MPU_STACK_GUARD
	def_bool y
	depends on HW_STACK_PROTECTION

config MPU_STACK_GUARD_MIN_SIZE
	int "Stack Guard area size"
	depends on MPU_STACK_GUARD
	default 512
	help
	  The Hardware Stack Protection implements a guard area at the bottom
	  of the stack using the MPU to catch stack overflows by marking that
	  guard area not accessible.

if CPU_TC18
config CPU_HAS_TRICORE_VIRTUALIZATION
	bool
	default n

config TRICORE_VIRTUALIZATION
	bool "Tricore Virtualization"
	default n

config TRICORE_VM_ID
	int "Tricore Virtual Machine ID"
	depends on TRICORE_VIRTUALIZATION
	default 0
endif

endmenu

config DCACHE_LINE_SIZE
	default 32

config ICACHE_LINE_SIZE
	default 32

config GEN_ISR_TABLES
	default y

config GEN_IRQ_VECTOR_TABLE
	default n

config NUM_IRQ_PRIORITIES
	int
	default 256

endmenu
```

## boards/ambiq/apollo2_evb/Kconfig.defconfig
```kconfig
# SPDX-License-Identifier: Apache-2.0
#
# Copyright (c) 2025 Linumiz GmbH
# Author: Sri Surya  <assrisurya@gmail.com>

if BOARD_APOLLO2_EVB

config SYS_CLOCK_HW_CYCLES_PER_SEC
	default 32768

endif
```

## boards/infineon/cytvii-b-h-8m-320-cpu/Kconfig.cytvii_b_h_8m_320_cpu
```kconfig
# Copyright (c) 2025 Infineon Technologies AG,
# or an affiliate of Infineon Technologies AG.
#
# SPDX-License-Identifier: Apache-2.0

config BOARD_CYTVII_B_H_8M_320_CPU
	select SOC_CYT4BFCCHE_M0PLUS if BOARD_CYTVII_B_H_8M_320_CPU_CYT4BFCCHE_M0P
	select SOC_CYT4BFCCHE_M7_0 if BOARD_CYTVII_B_H_8M_320_CPU_CYT4BFCCHE_M7_0
	select SOC_CYT4BFCCHE_M7_1 if BOARD_CYTVII_B_H_8M_320_CPU_CYT4BFCCHE_M7_1
```

## boards/infineon/cytvii-b-h-8m-320-cpu/Kconfig.defconfig
```kconfig
# Copyright 2026 Infineon Technologies AG
# SPDX-License-Identifier: Apache-2.0

if BOARD_CYTVII_B_H_8M_320_CPU

config NET_L2_ETHERNET
	default y if NETWORKING

config HAS_INFINEON_M0P_LAUNCHER_IMAGE
    bool
    default y

endif
```

## boards/infineon/cytvii-b-h-8m-320-cpu/board.yml
```yaml
# Copyright (c) 2025 Infineon Technologies AG,
# or an affiliate of Infineon Technologies AG.
#
# SPDX-License-Identifier: Apache-2.0

board:
  name: cytvii_b_h_8m_320_cpu
  full_name: T2G CYTVII-B-H-8M-320-CPU Evaluation Board
  vendor: infineon
  socs:
  - name: cyt4bfcche
```

## boards/infineon/cytvii-b-h-8m-320-cpu/cytvii_b_h_8m_320_cpu_cyt4bfcche_m7_1_defconfig
```kconfig
# Copyright (c) 2025 Infineon Technologies AG,
# or an affiliate of Infineon Technologies AG.
#
# SPDX-License-Identifier: Apache-2.0

# General configuration
CONFIG_ARM_MPU=y
CONFIG_HW_STACK_PROTECTION=y
CONFIG_CACHE_MANAGEMENT=y

# Enable console
CONFIG_CONSOLE=y
CONFIG_UART_CONSOLE=y

# Enable UART driver
CONFIG_SERIAL=y

# Enable GPIO driver
CONFIG_GPIO=y

# Enable clock controller
CONFIG_CLOCK_CONTROL=y

# Enable the M7_1 core board configuration
CONFIG_BOARD_CYTVII_B_H_8M_320_CPU_CYT4BFCCHE_M7_1=y

# Disable the M0+ core board configuration
CONFIG_BOARD_CYTVII_B_H_8M_320_CPU_CYT4BFCCHE_M0P=n
```

## boards/infineon/cytvii_b_e_1m_100_cpu/board.yml
```yaml
# Copyright (c) 2025 Infineon Technologies AG,
# or an affiliate of Infineon Technologies AG.
#
# SPDX-License-Identifier: Apache-2.0

board:
  name: cytvii_b_e_1m_100_cpu
  full_name: T2G CYTVII-B-E-1M-100-CPU Evaluation Board
  vendor: infineon
  socs:
  - name: cyt2b75cae
```

## boards/infineon/kit_t2g-b-h_lite/Kconfig.defconfig
```kconfig
# Copyright 2026 Infineon Technologies AG
# SPDX-License-Identifier: Apache-2.0

if BOARD_KIT_T2G_B_H_LITE

config NET_L2_ETHERNET
	default y if NETWORKING

config HAS_INFINEON_M0P_LAUNCHER_IMAGE
	bool 
	default y

endif
```

## boards/infineon/kit_t2g-b-h_lite/board.yml
```yaml
board:
  name: kit_t2g-b-h_lite
  full_name: Kit T2G Body High Lite 
  vendor: infineon
  socs:
  - name: cyt4bf8cds 
```

## boards/infineon/kit_t2g-b-h_lite/kit_t2g-b-h_lite_cyt4bf8cds_m7_0_defconfig
```kconfig
# Copyright (c) 2026 Infineon Technologies AG
# SPDX-License-Identifier: Apache-2.0
#

# General configuration
CONFIG_BUILD_OUTPUT_HEX=y
CONFIG_BUILD_OUTPUT_BIN=y
CONFIG_USE_DT_CODE_PARTITION=y

CONFIG_ARM_MPU=y
CONFIG_HW_STACK_PROTECTION=y
CONFIG_CACHE_MANAGEMENT=n

# Enable console
CONFIG_CONSOLE=y
CONFIG_UART_CONSOLE=y
CONFIG_UART_PDL_INFINEON_CAT1=y

# Enable UART driver
CONFIG_SERIAL=y

# Enable GPIO driver
CONFIG_GPIO=y

# Enable clock controller
CONFIG_CLOCK_CONTROL=y

CONFIG_SHELL=y
CONFIG_SHELL_BACKEND_SERIAL=y

# I2C Shell Test Configuration
CONFIG_I2C=y
CONFIG_I2C_SHELL=y

CONFIG_CLOCK_CONTROL_INFINEON_CAT1=y
```

## boards/infineon/kit_t2g_b_e_lite/kit_t2g_b_e_lite_defconfig
```kconfig
# Copyright (c) 2025 Infineon Technologies AG,
# or an affiliate of Infineon Technologies AG.
#
# SPDX-License-Identifier: Apache-2.0
# Enable console
CONFIG_CONSOLE=y

CONFIG_UART_CONSOLE=y

# Enable UART driver
CONFIG_SERIAL=y

# Enable GPIO driver
CONFIG_GPIO=y

# Enable clock controller
CONFIG_CLOCK_CONTROL=y

CONFIG_CORTEX_M_SYSTICK=y

CONFIG_SOC_CYT2BL_CM0P_IMAGE_SLEEP=y
```

## boards/infineon/kit_t2g_c2d6m_lite/Kconfig.kit_t2g_c2d6m_lite
```kconfig
# Copyright (c) 2025 Linumiz GmbH 
# SPDX-License-Identifier: Apache-2.0

config BOARD_KIT_T2G_C2D6M_LITE
	select SOC_CYT4DNJBZS_M0PLUS if BOARD_KIT_T2G_C2D6M_LITE_CYT4DNJBZS_M0P
	select SOC_CYT4DNJBZS_M7_0 if BOARD_KIT_T2G_C2D6M_LITE_CYT4DNJBZS_M7_0
	select SOC_CYT4DNJBZS_M7_1 if BOARD_KIT_T2G_C2D6M_LITE_CYT4DNJBZS_M7_1
	select SOC_CYT4DNJBZS_M7_SMP if BOARD_KIT_T2G_C2D6M_LITE_CYT4DNJBZS_M7_SMP
```

## boards/infineon/kit_t2g_c2d6m_lite/kit_t2g_c2d6m_lite_cyt4dnjbzs_m7_smp_defconfig
```kconfig
#
# Copyright (c) 2026 Linumiz
# SPDX-License-Identifier: Apache-2.0
#

# General configuration
CONFIG_BUILD_OUTPUT_HEX=y
CONFIG_BUILD_OUTPUT_BIN=y

CONFIG_ARM_MPU=y
CONFIG_HW_STACK_PROTECTION=y
CONFIG_CACHE_MANAGEMENT=n

# Enable console
CONFIG_CONSOLE=y
CONFIG_UART_CONSOLE=y
CONFIG_UART_PDL_INFINEON_CAT1=y

# Enable UART driver
CONFIG_SERIAL=y

# Enable GPIO driver
CONFIG_GPIO=y

# Enable clock controller
CONFIG_CLOCK_CONTROL=y

# SMP
CONFIG_SMP=y
CONFIG_MP_MAX_NUM_CPUS=2
CONFIG_USE_SWITCH=y
```

## boards/infineon/kit_tc4x7_com_trb/Kconfig.kit_tc4x7_com_trb
```kconfig
# Copyright 2024 Infineon Technologies AG
# SPDX-License-Identifier: Apache-2.0

config BOARD_KIT_TC4X7_COM_TRB_TC4D7XP
	bool
	default y if BOARD_KIT_TC4X7_COM_TRB_TC4D7XP_TC
	default y if BOARD_KIT_TC4X7_COM_TRB_TC4D7XP_TC0
	default y if BOARD_KIT_TC4X7_COM_TRB_TC4D7XP_TC1
	default y if BOARD_KIT_TC4X7_COM_TRB_TC4D7XP_TC2
	default y if BOARD_KIT_TC4X7_COM_TRB_TC4D7XP_TC3
	default y if BOARD_KIT_TC4X7_COM_TRB_TC4D7XP_TC4
	default y if BOARD_KIT_TC4X7_COM_TRB_TC4D7XP_TC5
	default y if BOARD_KIT_TC4X7_COM_TRB_TC4D7XP_CS

config BOARD_KIT_TC4X7_COM_TRB
	bool "Infineon TC4X7 COM TriBoard"
	select SOC_TC4D7XP if BOARD_KIT_TC4X7_COM_TRB_TC4D7XP

config TRICORE_CORE_ID
	int
	default 0 if BOARD_KIT_TC4X7_COM_TRB_TC4D7XP_TC0
	default 1 if BOARD_KIT_TC4X7_COM_TRB_TC4D7XP_TC1
	default 2 if BOARD_KIT_TC4X7_COM_TRB_TC4D7XP_TC2
	default 3 if BOARD_KIT_TC4X7_COM_TRB_TC4D7XP_TC3
	default 4 if BOARD_KIT_TC4X7_COM_TRB_TC4D7XP_TC4
	default 5 if BOARD_KIT_TC4X7_COM_TRB_TC4D7XP_TC5
	default 6 if BOARD_KIT_TC4X7_COM_TRB_TC4D7XP_CS
	default 0 
```

## boards/infineon/kit_tc4x7_com_trb/kit_tc4x7_com_trb_tc4d7xp_tc_defconfig
```kconfig
CONFIG_SERIAL=y
CONFIG_GPIO=y
CONFIG_LED=y

CONFIG_CONSOLE=y
CONFIG_UART_CONSOLE=y
```

## boards/ti/lp_mspm0c1104/Kconfig.lp_mspm0c1104
```kconfig
# Copyright (c) 2025 Linuiz
# SPDX-License-Identifier: Apache-2.0

config BOARD_LP_MSPM0C1104
	select SOC_MSPM0C1104
```

## drivers/adc/Kconfig.ifx
```kconfig
# Copyright (c) 2025 Linumiz GmbH
#
# SPDX-License-Identifier: Apache-2.0

config ADC_INFINEON_SAR_CAT1
        bool "Infineon CAT1 SAR driver"
        default y
        depends on DT_HAS_INFINEON_IFX_SAR_ENABLED
	select USE_INFINEON_ADC
        select ADC_CONFIGURABLE_INPUTS
        help
          This option enables the SAR driver for Infineon CAT1 family.
```

## drivers/audio/Kconfig.tas2563
```kconfig
# Copyright (c) 2025 Linumiz GmbH
# SPDX-License-Identifier: Apache-2.0

config AUDIO_TAS2563
        bool "TAS6422 audio amplifier support"
        default y
        depends on DT_HAS_TI_TAS2563_ENABLED
        select I2C
        depends on GPIO
        help
          Enable TAS2563 support on the selected board
config TAS2563_IRQ_GPIO_SUPPORT
	bool "interrupt support"
	default n
	depends on AUDIO_TAS2563
	help
	  Enable the irq support
```

## drivers/charger/Kconfig.bq2562x
```kconfig
# Copyright 2025 Linumiz
# SPDX-License-Identifier: Apache-2.0

config CHARGER_BQ2562X
	bool "BQ2562X Battery Charger"
	default y
	depends on DT_HAS_TI_BQ2562X_CHARGER_ENABLED
	depends on DT_HAS_TI_BQ2562X_ENABLED
	select MFD
	help
	  Enable MFD-based driver for the TI BQ2562X Battery Charger.
```

## drivers/charger/Kconfig.mp2733
```kconfig
config CHARGER_MP2733
        bool "MP2733 Battery Charger"
        default y
        select I2C
        help
          Enable I2C-based driver for the TI BQ24190 Battery Charger.
```

## drivers/comparator/Kconfig.mspm0_comp
```kconfig
# TI MSPM0 Family

# Copyright (c) 2025, Linumiz GmbH
# SPDX-License-Identifier: Apache-2.0

config COMPARATOR_MSPM0
	bool "TI MSPM0 Comparator driver"
	default y
	depends on DT_HAS_TI_MSPM0_COMPARATOR_ENABLED
	select PINCTRL
	select SHARED_INTERRUPTS
	help
	  Enable driver for the Texas Instruments MSPM0 series comparators.
	  Supports reference voltage configuration and internal DAC control.
```

## drivers/crypto/Kconfig.mspm0
```kconfig
# Copyright (c) 2025 Linumiz GmbH

# SPDX-License-Identifier: Apache-2.0

config CRYPTO_MSPM0_AES
	bool "TI MSPM0 AES driver support"
	default y
	depends on DT_HAS_TI_MSPM0_AES_ENABLED
	depends on CRYPTO
	select USE_MSPM0_DL_AES
	help
	  Enable TI MSPM0 AES driver support
```
