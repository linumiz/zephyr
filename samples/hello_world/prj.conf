## CMakeLists.txt
```
# SPDX-License-Identifier: Apache-2.0

cmake_minimum_required(VERSION 3.13.1)

find_package(Zephyr REQUIRED HINTS $ENV{ZEPHYR_BASE})
project(hello_world)

target_sources(app PRIVATE src/unit-test-client.c)
```

## prj.conf
```kconfig
# nothing here
CONFIG_CLOCK_CONTROL_IFX_CAT1_FIXED_CLOCK=n
CONFIG_CLOCK_CONTROL_IFX_CAT1_FIXED_FACTOR_CLOCK=n
CONFIG_CLOCK_CONTROL_IFX_CAT1_PERI_CLOCK=n
CONFIG_CLOCK_CONTROL_INFINEON_CAT1=n
CONFIG_PINCTRL_INFINEON_CAT1=n
CONFIG_PINCTRL=n
CONFIG_GPIO_INFINEON_CAT1=n
CONFIG_GPIO=n
CONFIG_UART_PDL_INFINEON_CAT1=n
CONFIG_UART_CONSOLE=n
CONFIG_SHELL=n
```

## src/main.c
```c
/*
 * Copyright (c) 2012-2014 Wind River Systems, Inc.
 *
 * SPDX-License-Identifier: Apache-2.0
 */

#include <stdio.h>
#include <cmsis_gcc.h>

int main(void)
{
	__WFI();
	printf("Hello World! %s\n", CONFIG_BOARD_TARGET);

	return 0;
}
```
