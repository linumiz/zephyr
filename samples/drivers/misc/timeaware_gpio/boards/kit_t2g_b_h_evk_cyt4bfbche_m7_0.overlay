tgpio: &tcpwm1_grp0_tgpio {
	ifx,peri-group = <IFX_PERI_GRP_INST_SEL(1, 0)>;
	divider-type = <1>;   /* 16-bit divider */
	divider-sel = <0>;    /* instance #0 */
	divider-val = <3000>;    /* no division */
	status = "okay";
};

&tgpio1_ch0_58 {
	pinctrl-0 = <&p17_3_tc1_58_tr>;
	pinctrl-names = "default";
	status = "okay";
};

&tgpio1_ch0_62 {
	pinctrl-0 = <&p16_2_pwm1_62_line_out>;
    pinctrl-names = "default";
	status = "okay";
};