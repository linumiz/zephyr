## soc/infineon/cat1a/tvii-b-e/Kconfig.soc
```kconfig
# Copyright (c) 2026 Infineon Technologies AG,
# or an affiliate of Infineon Technologies AG.
# SPDX-License-Identifier: Apache-2.0


# SOC Series
config SOC_SERIES_TVII_B_E
    bool
    select SOC_FAMILY_INFINEON_CAT1
    select SOC_FAMILY_INFINEON_CAT1A
	select DYNAMIC_INTERRUPTS
	select USE_INFINEON_LEGACY_HAL
    select BUILD_OUTPUT_HEX

# SOC die
config SOC_DIE_CYT2BL
    bool

config SOC_DIE_CYT2B7
	bool

# SOC packages
config SOC_PACKAGE_CYT2BL_176_LQFP
    bool

config SOC_PACKAGE_CYT2BL_144_LQFP
    bool

config SOC_PACKAGE_CYT2BL_100_LQFP
    bool

config SOC_PACKAGE_CYT2BL_80_LQFP
    bool

config SOC_PACKAGE_CYT2BL_64_LQFP
    bool

config SOC_PACKAGE_CYT2B7_64_LQFP
    bool

config SOC_PACKAGE_CYT2B7_80_LQFP
    bool

config SOC_PACKAGE_CYT2B7_100_LQFP
    bool

config SOC_PACKAGE_CYT2B7_144_LQFP
    bool

config SOC_PACKAGE_CYT2B7_176_LQFP
    bool

# Infineon CYT2BL series MCUs
config SOC_CYT2BL3BAS
    bool
    select SOC_DIE_CYT2BL
    select SOC_PACKAGE_CYT2BL_64_LQFP
    select SOC_SERIES_TVII_B_E

config SOC_CYT2BL3BAE
    bool
    select SOC_DIE_CYT2BL
    select SOC_PACKAGE_CYT2BL_64_LQFP
    select SOC_SERIES_TVII_B_E

config SOC_CYT2BL3CAS
    bool
    select SOC_DIE_CYT2BL
    select SOC_PACKAGE_CYT2BL_64_LQFP
    select SOC_SERIES_TVII_B_E

config SOC_CYT2BL3CAE
    bool
    select SOC_DIE_CYT2BL
    select SOC_PACKAGE_CYT2BL_64_LQFP
    select SOC_SERIES_TVII_B_E

config SOC_CYT2BL4BAS
    bool
    select SOC_DIE_CYT2BL
    select SOC_PACKAGE_CYT2BL_80_LQFP
    select SOC_SERIES_TVII_B_E

config SOC_CYT2BL4BAE
    bool
    select SOC_DIE_CYT2BL
    select SOC_PACKAGE_CYT2BL_80_LQFP
    select SOC_SERIES_TVII_B_E

config SOC_CYT2BL4CAS
    bool
    select SOC_DIE_CYT2BL
    select SOC_PACKAGE_CYT2BL_80_LQFP
    select SOC_SERIES_TVII_B_E

config SOC_CYT2BL4CAE
    bool
    select SOC_DIE_CYT2BL
    select SOC_PACKAGE_CYT2BL_80_LQFP
    select SOC_SERIES_TVII_B_E

config SOC_CYT2BL5BAS
    bool
    select SOC_DIE_CYT2BL
    select SOC_PACKAGE_CYT2BL_100_LQFP
    select SOC_SERIES_TVII_B_E

config SOC_CYT2BL5BAE
    bool
    select SOC_DIE_CYT2BL
    select SOC_PACKAGE_CYT2BL_100_LQFP
    select SOC_SERIES_TVII_B_E

config SOC_CYT2BL5CAS
    bool
    select SOC_DIE_CYT2BL
    select SOC_PACKAGE_CYT2BL_100_LQFP
    select SOC_SERIES_TVII_B_E

config SOC_CYT2BL5CAE
    bool
    select SOC_DIE_CYT2BL
    select SOC_PACKAGE_CYT2BL_100_LQFP
    select SOC_SERIES_TVII_B_E

config SOC_CYT2BL7BAS
    bool
    select SOC_DIE_CYT2BL
    select SOC_PACKAGE_CYT2BL_144_LQFP
    select SOC_SERIES_TVII_B_E

config SOC_CYT2BL7BAE
    bool
    select SOC_DIE_CYT2BL
    select SOC_PACKAGE_CYT2BL_144_LQFP
    select SOC_SERIES_TVII_B_E

config SOC_CYT2BL7CAS
    bool
    select SOC_DIE_CYT2BL
    select SOC_PACKAGE_CYT2BL_144_LQFP
    select SOC_SERIES_TVII_B_E

config SOC_CYT2BL7CAE
    bool
    select SOC_DIE_CYT2BL
    select SOC_PACKAGE_CYT2BL_144_LQFP
    select SOC_SERIES_TVII_B_E

config SOC_CYT2BL8BAS
    bool
    select SOC_DIE_CYT2BL
    select SOC_PACKAGE_CYT2BL_176_LQFP
    select SOC_SERIES_TVII_B_E

config SOC_CYT2BL8BAE
    bool
    select SOC_DIE_CYT2BL
    select SOC_PACKAGE_CYT2BL_176_LQFP
    select SOC_SERIES_TVII_B_E

config SOC_CYT2BL8CAS
    bool
    select SOC_DIE_CYT2BL
    select SOC_PACKAGE_CYT2BL_176_LQFP
    select SOC_SERIES_TVII_B_E

config SOC_CYT2BL8CAE
    bool
    select SOC_DIE_CYT2BL
    select SOC_PACKAGE_CYT2BL_176_LQFP
    select SOC_SERIES_TVII_B_E

# Infineon CYT2B7 series MCUs
config SOC_CYT2B73BAS
    bool
    select SOC_DIE_CYT2B7
    select SOC_PACKAGE_CYT2B7_64_LQFP
    select SOC_SERIES_TVII_B_E

config SOC_CYT2B73BAE
    bool
    select SOC_DIE_CYT2B7
    select SOC_PACKAGE_CYT2B7_64_LQFP
    select SOC_SERIES_TVII_B_E

config SOC_CYT2B73CAS
    bool
    select SOC_DIE_CYT2B7
    select SOC_PACKAGE_CYT2B7_64_LQFP
    select SOC_SERIES_TVII_B_E

config SOC_CYT2B73CAE
    bool
    select SOC_DIE_CYT2B7
    select SOC_PACKAGE_CYT2B7_64_LQFP
    select SOC_SERIES_TVII_B_E

config SOC_CYT2B74BAS
    bool
    select SOC_DIE_CYT2B7
    select SOC_PACKAGE_CYT2B7_80_LQFP
    select SOC_SERIES_TVII_B_E

config SOC_CYT2B74BAE
    bool
    select SOC_DIE_CYT2B7
    select SOC_PACKAGE_CYT2B7_80_LQFP
    select SOC_SERIES_TVII_B_E

config SOC_CYT2B74CAS
    bool
    select SOC_DIE_CYT2B7
    select SOC_PACKAGE_CYT2B7_80_LQFP
    select SOC_SERIES_TVII_B_E

config SOC_CYT2B74CAE
    bool
    select SOC_DIE_CYT2B7
    select SOC_PACKAGE_CYT2B7_80_LQFP
    select SOC_SERIES_TVII_B_E

config SOC_CYT2B75BAS
    bool
    select SOC_DIE_CYT2B7
    select SOC_PACKAGE_CYT2B7_100_LQFP
    select SOC_SERIES_TVII_B_E

config SOC_CYT2B75BAE
    bool
    select SOC_DIE_CYT2B7
    select SOC_PACKAGE_CYT2B7_100_LQFP
    select SOC_SERIES_TVII_B_E

config SOC_CYT2B75CAS
    bool
    select SOC_DIE_CYT2B7
    select SOC_PACKAGE_CYT2B7_100_LQFP
    select SOC_SERIES_TVII_B_E

config SOC_CYT2B75CAE
    bool
    select SOC_DIE_CYT2B7
    select SOC_PACKAGE_CYT2B7_100_LQFP
    select SOC_SERIES_TVII_B_E

config SOC_CYT2B77BAS
    bool
    select SOC_DIE_CYT2B7
    select SOC_PACKAGE_CYT2B7_144_LQFP
    select SOC_SERIES_TVII_B_E

config SOC_CYT2B77BAE
    bool
    select SOC_DIE_CYT2B7
    select SOC_PACKAGE_CYT2B7_144_LQFP
    select SOC_SERIES_TVII_B_E

config SOC_CYT2B77CAS
    bool
    select SOC_DIE_CYT2B7
    select SOC_PACKAGE_CYT2B7_144_LQFP
    select SOC_SERIES_TVII_B_E

config SOC_CYT2B77CAE
    bool
    select SOC_DIE_CYT2B7
    select SOC_PACKAGE_CYT2B7_144_LQFP
    select SOC_SERIES_TVII_B_E

config SOC_CYT2B78BAS
    bool
    select SOC_DIE_CYT2B7
    select SOC_PACKAGE_CYT2B7_176_LQFP
    select SOC_SERIES_TVII_B_E

config SOC_CYT2B78BAE
    bool
    select SOC_DIE_CYT2B7
    select SOC_PACKAGE_CYT2B7_176_LQFP
    select SOC_SERIES_TVII_B_E

config SOC_CYT2B78CAS
    bool
    select SOC_DIE_CYT2B7
    select SOC_PACKAGE_CYT2B7_176_LQFP
    select SOC_SERIES_TVII_B_E

config SOC_CYT2B78CAE
    bool
    select SOC_DIE_CYT2B7
    select SOC_PACKAGE_CYT2B7_176_LQFP
    select SOC_SERIES_TVII_B_E

config SOC
    default "cyt2bl3bas" if SOC_CYT2BL3BAS
    default "cyt2bl3bae" if SOC_CYT2BL3BAE
    default "cyt2bl3cas" if SOC_CYT2BL3CAS
    default "cyt2bl3cae" if SOC_CYT2BL3CAE
    default "cyt2bl4bas" if SOC_CYT2BL4BAS
    default "cyt2bl4bae" if SOC_CYT2BL4BAE
    default "cyt2bl4cas" if SOC_CYT2BL4CAS
    default "cyt2bl4cae" if SOC_CYT2BL4CAE
    default "cyt2bl5bas" if SOC_CYT2BL5BAS
    default "cyt2bl5bae" if SOC_CYT2BL5BAE
    default "cyt2bl5cas" if SOC_CYT2BL5CAS
    default "cyt2bl5cae" if SOC_CYT2BL5CAE
    default "cyt2bl7bas" if SOC_CYT2BL7BAS
    default "cyt2bl7bae" if SOC_CYT2BL7BAE
    default "cyt2bl7cas" if SOC_CYT2BL7CAS
    default "cyt2bl7cae" if SOC_CYT2BL7CAE
    default "cyt2bl8bas" if SOC_CYT2BL8BAS
    default "cyt2bl8bae" if SOC_CYT2BL8BAE
    default "cyt2bl8cas" if SOC_CYT2BL8CAS
    default "cyt2bl8cae" if SOC_CYT2BL8CAE
    default "cyt2b73bas" if SOC_CYT2B73BAS
    default "cyt2b73bae" if SOC_CYT2B73BAE
    default "cyt2b73cas" if SOC_CYT2B73CAS
    default "cyt2b73cae" if SOC_CYT2B73CAE
    default "cyt2b74bas" if SOC_CYT2B74BAS
    default "cyt2b74bae" if SOC_CYT2B74BAE
    default "cyt2b74cas" if SOC_CYT2B74CAS
    default "cyt2b74cae" if SOC_CYT2B74CAE
    default "cyt2b75bas" if SOC_CYT2B75BAS
    default "cyt2b75bae" if SOC_CYT2B75BAE
    default "cyt2b75cas" if SOC_CYT2B75CAS
    default "cyt2b75cae" if SOC_CYT2B75CAE
    default "cyt2b77bas" if SOC_CYT2B77BAS
    default "cyt2b77bae" if SOC_CYT2B77BAE
    default "cyt2b77cas" if SOC_CYT2B77CAS
    default "cyt2b77cae" if SOC_CYT2B77CAE
    default "cyt2b78bas" if SOC_CYT2B78BAS
    default "cyt2b78bae" if SOC_CYT2B78BAE
    default "cyt2b78cas" if SOC_CYT2B78CAS
    default "cyt2b78cae" if SOC_CYT2B78CAE
```

## soc/infineon/cat1a/tvii-b-e/Kconfig.sysbuild
```kconfig
if SOC_SERIES_TVII_B_E

config HAS_INFINEON_M0P_LAUNCHER_IMAGE
    default y

endif

orsource "*/Kconfig.sysbuild"
```

## soc/infineon/cat1a/tvii-b-e/m0p/Kconfig
```kconfig
# Copyright (c) 2026 Infineon Technolgies AG
# SPDX-License-Identifier: Apache-2.0

config INFINEON_CAT1A_M0PLUS
	bool
	select ARM
	select CPU_CORTEX_M0PLUS
	select CPU_CORTEX_M_HAS_SYSTICK
	select CPU_CORTEX_M_HAS_VTOR
	select CPU_HAS_ARM_MPU
	select ARM_CUSTOM_INTERRUPT_CONTROLLER
	select SOC_PREP_HOOK

config INFINEON_CAT1A_START_M4
	bool "Infineon M4 during M0+ startup"
	default y
	help
	  Enable starting M4 core 0 from M0+ core.
```

## soc/infineon/cat1a/tvii-b-e/m4/Kconfig
```kconfig
# Copyright (c) 2026 Infineon Technologies AG
# SPDX-License-Identifier: Apache-2.0

config INFINEON_CAT1A_M4
    bool
	select ARM
    select CPU_CORTEX_M4 
	select CPU_CORTEX_M_HAS_SYSTICK
	select CPU_CORTEX_M_HAS_VTOR
	select CPU_HAS_ARM_MPU
	select CPU_HAS_FPU
    select ARM_CUSTOM_INTERRUPT_CONTROLLER
	select SOC_PREP_HOOK
```

## soc/infineon/cat1c/Kconfig
```kconfig
# Copyright (c) 2024 Cypress Semiconductor Corporation (an Infineon company) or
# an affiliate of Cypress Semiconductor Corporation
# SPDX-License-Identifier: Apache-2.0

if SOC_FAMILY_INFINEON_CAT1C

rsource "*/Kconfig"

config INFINEON_TRAVEO_FAMILY
        bool "Enable Infineon TRAVEO family PDL driver support"
	default n
        help
          Enable PDL-based drivers for Infineon TRAVEO SoCs.

endif # SOC_FAMILY_INFINEON_CAT1C
```

## soc/infineon/cat1c/cyt4dn/Kconfig.defconfig
```kconfig
# Copyright (c) 2026 Linumiz
# Copyright (c) 2026 Infineon Technologies AG
# SPDX-License-Identifier: Apache-2.0

# Infineon CAT1C based MCU default configuration

if SOC_SERIES_CYT4DN

# Cortex-M7 has additional 8 software irqs directly connected to IRQ lines
config NUM_IRQS
	default 794 if INFINEON_CAT1C_M0PLUS
	default 802 if INFINEON_CAT1C_M7

choice INFINEON_CAT1C_CORE
	default INFINEON_CAT1C_M0PLUS if SOC_CYT4DNJBZS_M0PLUS
	default INFINEON_CAT1C_M7_0 if SOC_CYT4DNJBZS_M7_0
	default INFINEON_CAT1C_M7_1 if SOC_CYT4DNJBZS_M7_1
endchoice

config SYS_CLOCK_HW_CYCLES_PER_SEC
	default $(dt_node_int_prop_int,/cpus/cpu@0,clock-frequency) if INFINEON_CAT1C_M0PLUS
	default $(dt_node_int_prop_int,/cpus/cpu@1,clock-frequency) if INFINEON_CAT1C_M7_0
	default $(dt_node_int_prop_int,/cpus/cpu@2,clock-frequency) if INFINEON_CAT1C_M7_1

config INFINEON_INTC_CAT1
	default y

config GEN_IRQ_VECTOR_TABLE
	default n

config BUILD_OUTPUT_HEX
	default y

endif # SOC_SERIES_CYT4DN
```

## soc/infineon/cat1c/cyt4dn/m0p/Kconfig
```kconfig
# Copyright (c) 2026 Linumiz
# Copyright (c) 2026 Infineon Technologies AG
# SPDX-License-Identifier: Apache-2.0

if SOC_SERIES_CYT4DN

config INFINEON_CAT1C_M0PLUS
	bool
	select ARM
	select CPU_CORTEX_M0PLUS
	select CPU_CORTEX_M_HAS_SYSTICK
	select CPU_HAS_ARM_MPU
	select CPU_CORTEX_M_HAS_VTOR
	select ARM_CUSTOM_INTERRUPT_CONTROLLER
	select SOC_PREP_HOOK

config INFINEON_CAT1C_START_M7_0
	bool "Infineon M7 Core 0 during M0+ startup"
	default y
	help
	  Enable starting M7 core 0 from M0+ core.

config INFINEON_CAT1C_START_M7_1
	bool "Infineon M7 Core 1 during M0+ startup"
	default y
	help
	  Enable starting M7 core 1 from M0+ core.

endif
```

## soc/infineon/cat1c/cyt4dn/m7/Kconfig
```kconfig
# Copyright (c) 2026 Linumiz
# Copyright (c) 2026 Infineon Technologies AG
# SPDX-License-Identifier: Apache-2.0

if SOC_SERIES_CYT4DN

config INFINEON_CAT1C_M7
	bool
	select ARM
	select CPU_CORTEX_M7
	select CPU_CORTEX_M_HAS_SYSTICK
	select CPU_CORTEX_M_HAS_VTOR
	select CPU_HAS_ARM_MPU
	select CPU_HAS_ICACHE
	select CPU_HAS_DCACHE
	select CPU_HAS_FPU
	select ARM_CUSTOM_INTERRUPT_CONTROLLER
	select SOC_PREP_HOOK
	select SOC_EARLY_INIT_HOOK

config INFINEON_CAT1C_M7_0
	select INFINEON_CAT1C_M7

config INFINEON_CAT1C_M7_1
	select INFINEON_CAT1C_M7

endif
```
