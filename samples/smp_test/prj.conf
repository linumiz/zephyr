## CMakeLists.txt
```
# SPDX-License-Identifier: Apache-2.0

cmake_minimum_required(VERSION 3.20.0)

find_package(Zephyr REQUIRED HINTS $ENV{ZEPHYR_BASE})
project(smp_test)

target_sources(app PRIVATE src/main.c)
```

## prj.conf
```kconfig
# IFX RELATED
CONFIG_CLOCK_CONTROL_IFX_CAT1_FIXED_CLOCK=y
CONFIG_CLOCK_CONTROL_IFX_CAT1_FIXED_FACTOR_CLOCK=n
CONFIG_CLOCK_CONTROL_IFX_CAT1_PERI_CLOCK=n
CONFIG_CLOCK_CONTROL_INFINEON_CAT1=y
CONFIG_PINCTRL_INFINEON_CAT1=y
CONFIG_PINCTRL=y
CONFIG_GPIO_INFINEON_CAT1=y
CONFIG_GPIO=y
CONFIG_UART_PDL_INFINEON_CAT1=y
CONFIG_UART_CONSOLE=y
CONFIG_SHELL=n

CONFIG_DCACHE=n

# Application Configuration
# Enable printk for debug output
CONFIG_PRINTK=y

# Enable GPIO for LED control
CONFIG_GPIO=y

# Thread configuration
CONFIG_MAIN_STACK_SIZE=2048
CONFIG_IDLE_STACK_SIZE=512
CONFIG_TICKLESS_KERNEL=n
```

## src/main.c
```c
#include <zephyr/kernel.h>
#include <zephyr/device.h>
#include <zephyr/drivers/gpio.h>
#include <zephyr/sys/printk.h>

#define led0_THREAD_STACK_SIZE  1024
#define led1_THREAD_STACK_SIZE  1024
K_THREAD_STACK_DEFINE(led0_thread_stack, led0_THREAD_STACK_SIZE);
K_THREAD_STACK_DEFINE(led1_thread_stack, led1_THREAD_STACK_SIZE);
static struct k_thread led0_thread_data;
static struct k_thread led1_thread_data;

#define led0_NODE DT_ALIAS(led0)
static const struct gpio_dt_spec led0 = GPIO_DT_SPEC_GET(led0_NODE, gpios);

#define led1_NODE DT_ALIAS(led1)
static const struct gpio_dt_spec led1 = GPIO_DT_SPEC_GET(led1_NODE, gpios);

static void led0_thread_entry(void *p1, void *p2, void *p3)
{
	ARG_UNUSED(p1); ARG_UNUSED(p2); ARG_UNUSED(p3);

	bool led0_state = false;

	if (!gpio_is_ready_dt(&led0)) {
		return;
	}

	gpio_pin_configure_dt(&led0, GPIO_OUTPUT_INACTIVE);

	while (1) {
		led0_state = !led0_state;
		gpio_pin_set_dt(&led0, led0_state);
		printk("\nLED T0: CPU: %d\n", _current_cpu->id);
		k_busy_wait(50000);
	}
}

static void led1_thread_entry(void *p1, void *p2, void *p3)
{
	ARG_UNUSED(p1); ARG_UNUSED(p2); ARG_UNUSED(p3);

	bool led1_state = false;

	if (!gpio_is_ready_dt(&led1)) {
		return;
	}

	gpio_pin_configure_dt(&led1, GPIO_OUTPUT_INACTIVE);

	while (1) {
		led1_state = !led1_state;
		gpio_pin_set_dt(&led1, led1_state);
		printk("\nLED T1: CPU: %d\n", _current_cpu->id);
		k_busy_wait(50000);
	}
}

int main(void)
{
	printk("Main thread from core: [M7_%d]\n", _current_cpu->id);

	k_thread_create(&led0_thread_data,
	                                led0_thread_stack,
	                                led0_THREAD_STACK_SIZE,
	                                led0_thread_entry,
	                                NULL, NULL, NULL,
	                                5,
	                                0,
	                                K_NO_WAIT);

	k_thread_create(&led1_thread_data,
	                                led1_thread_stack,
	                                led1_THREAD_STACK_SIZE,
	                                led1_thread_entry,
	                                NULL, NULL, NULL,
	                                5,
	                                0,
	                                K_NO_WAIT);
	return 0;
}
```
