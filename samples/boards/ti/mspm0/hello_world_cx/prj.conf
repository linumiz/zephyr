## prj.conf
```kconfig
# nothing here
CONFIG_MAIN_STACK_SIZE=320
CONFIG_IDLE_STACK_SIZE=96
CONFIG_ISR_STACK_SIZE=256

CONFIG_MULTITHREADING=y
CONFIG_SYSTEM_WORKQUEUE_STACK_SIZE=1
CONFIG_SIZE_OPTIMIZATIONS_AGGRESSIVE=y
CONFIG_EXCEPTION_DEBUG=n
CONFIG_KERNEL_MEM_POOL=n

CONFIG_SYS_CLOCK_TICKS_PER_SEC=10000
CONFIG_TI_MSPM0_TIMER=y

# CONFIG_THREAD_ANALYZER=y
# CONFIG_THREAD_ANALYZER_USE_PRINTK=y
# CONFIG_THREAD_ANALYZER_AUTO=y
# CONFIG_THREAD_ANALYZER_AUTO_INTERVAL=5

# 
# CONFIG_NUM_COOP_PRIORITIES=0
# CONFIG_SCHED_DEADLINE=y
# CONFIG_SCHED_SCALABLE=y
# CONFIG_SCHED_MULTIQ=y

CONFIG_I2C=n
CONFIG_COMMON_LIBC_MALLOC=y

CONFIG_CONSOLE=y
CONFIG_UART_CONSOLE=y
CONFIG_UART_MSPM0=y

CONFIG_PRINTK=y
CONFIG_EARLY_CONSOLE=y
CONFIG_BOOT_BANNER=y
CONFIG_ERRNO=y
CONFIG_MINIMAL_LIBC_OPTIMIZE_STRING_FOR_SIZE=y
CONFIG_MINIMAL_LIBC=y
CONFIG_PICOLIBC=n

# from minimal
CONFIG_ARM_MPU=n
CONFIG_UART_USE_RUNTIME_CONFIGURE=n
CONFIG_UART_INTERRUPT_DRIVEN=n

# libs
CONFIG_CBPRINTF_NANO=y
CONFIG_CBPRINTF_REDUCED_INTEGRAL=y
CONFIG_CBPRINTF_LIBC_SUBSTS=n

# build
CONFIG_FPU=n
CONFIG_SIZE_OPTIMIZATIONS=y

# Boot
CONFIG_BOOT_DELAY=0

# Power management
CONFIG_PM=n

# Interrupts
CONFIG_DYNAMIC_INTERRUPTS=n
CONFIG_IRQ_OFFLOAD=n

# Memory protection
CONFIG_THREAD_STACK_INFO=n
CONFIG_THREAD_CUSTOM_DATA=n

# Console
CONFIG_STDOUT_CONSOLE=n

CONFIG_NUM_COOP_PRIORITIES=16
CONFIG_NUM_METAIRQ_PRIORITIES=0

CONFIG_SCHED_DUMB=y
CONFIG_WAITQ_DUMB=y

CONFIG_NUM_PREEMPT_PRIORITIES=0

CONFIG_I2C_MSPM0_MULTI_TARGET_ADDRESS=n
CONFIG_I2C_TARGET=n

CONFIG_INIT_STACKS=y
CONFIG_THREAD_STACK_INFO=y
```

## src/main.c
```c
/*
 * Copyright (c) 2025 Linumiz GmbH
 *
 * SPDX-License-Identifier: Apache-2.0
 */

#include <stdio.h>
#include <zephyr/kernel.h>
#include <stdlib.h>

static void print_stack_usage(const char *name, k_tid_t tid,
                              size_t total_stack_bytes)
{
	size_t unused = 0;
	int rc = k_thread_stack_space_get(tid, &unused);
	if (rc == 0) {
		size_t used = total_stack_bytes - unused;
		printk("[%s] stack: used=%u bytes, unused=%u, total=%u\n",
				name ? name : "?", (unsigned)used, (unsigned)unused,
				(unsigned)total_stack_bytes);
	} else {
		printk("[%s] k_thread_stack_space_get failed: %d\n",
				name ? name : "?", rc);
	}
}

K_MUTEX_DEFINE(size_check);
int main(void)
{
	void *mem = malloc(1);
	free(mem);

	k_msleep(1000);
	print_stack_usage("sleep", k_current_get(), CONFIG_MAIN_STACK_SIZE);

	k_mutex_lock(&size_check, K_FOREVER);
	print_stack_usage("mutex_lock", k_current_get(), CONFIG_MAIN_STACK_SIZE);
	k_mutex_unlock(&size_check);
	print_stack_usage("mutex_unlock", k_current_get(), CONFIG_MAIN_STACK_SIZE);

	return 0;
}
```
