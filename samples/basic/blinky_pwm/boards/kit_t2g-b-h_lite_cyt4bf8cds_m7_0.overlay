/*
 * Copyright (c) 2026 Infineon Technologies AG
 *
 * SPDX-License-Identifier: Apache-2.0
 */

&tcpwm1_grp0_pwm {
	ifx,peri-group = <IFX_PERI_GRP_INST_SEL(1, 0)>;
	status = "okay";
};

&pwm1_ch0_9 {
	divider-type = <1>;
	divider-sel = <0>;
	divider-val = <2000>;
	pinctrl-names = "default";
	pinctrl-0 = <&p5_0_pwm1_9_line_out>;
	status = "okay";
};


