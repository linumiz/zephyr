&tcpwm0_grp0_pwm {
	ifx,peri-group = <IFX_PERI_GRP_INST_SEL(0, 0)>;
	status = "okay";
};

&pwm_ch0_21 {
	divider-type = <1>;
    divider-sel = <0>;
    divider-val = <1000>;
	pinctrl-names = "default";
	pinctrl-0 = <&p8_2_pwm0_21_line_out>;
	status = "okay";
};
