## prj.conf
```kconfig
CONFIG_CLOCK_CONTROL_IFX_CAT1_FIXED_CLOCK=y
CONFIG_CLOCK_CONTROL_IFX_CAT1_FIXED_FACTOR_CLOCK=n
CONFIG_CLOCK_CONTROL_IFX_CAT1_PERI_CLOCK=n
CONFIG_CLOCK_CONTROL_INFINEON_CAT1=y
CONFIG_PINCTRL_INFINEON_CAT1=y
CONFIG_PINCTRL=y
CONFIG_GPIO_INFINEON_CAT1=y
CONFIG_GPIO=y
CONFIG_UART_PDL_INFINEON_CAT1=y

CONFIG_NETWORKING=y
CONFIG_NET_IPV6=n
CONFIG_NET_IPV4=y
CONFIG_NET_ARP=y
CONFIG_NET_UDP=y
CONFIG_NET_DHCPV4=y
CONFIG_NET_DHCPV4_OPTION_CALLBACKS=y
CONFIG_DNS_RESOLVER=y

CONFIG_TEST_RANDOM_GENERATOR=y

CONFIG_INIT_STACKS=y

CONFIG_NET_MGMT=y
CONFIG_NET_MGMT_EVENT=y

CONFIG_NET_LOG=y
CONFIG_LOG=y

CONFIG_SLIP_STATISTICS=n
CONFIG_NET_SHELL=y
CONFIG_SHELL=y
CONFIG_ETH_XLNX_GEM=y
CONFIG_MDIO_XLNX_GEM=y
CONFIG_PHY_REALTEK_RTL8211F=y
CONFIG_ETH_DRIVER=y
CONFIG_MDIO=y
CONFIG_ETH_DRIVER=y
CONFIG_NET_L2_ETHERNET=y

CONFIG_NET_PKT_TX_COUNT=20
CONFIG_NET_PKT_RX_COUNT=20
```

## src/main.c
```c
/*
 * Copyright (c) 2016 Intel Corporation
 *
 * SPDX-License-Identifier: Apache-2.0
 */

#include <stdio.h>
#include <zephyr/kernel.h>
#include <zephyr/drivers/gpio.h>

/* 1000 msec = 1 sec */
#define SLEEP_TIME_MS   1000

/* The devicetree node identifier for the "led0" alias. */
#define LED0_NODE DT_ALIAS(led0)

/*
 * A build error on this line means your board is unsupported.
 * See the sample documentation for information on how to fix this.
 */
static const struct gpio_dt_spec led = GPIO_DT_SPEC_GET(LED0_NODE, gpios);

int main(void)
{
	int ret;
	bool led_state = true;

	if (!gpio_is_ready_dt(&led)) {
		return 0;
	}

	ret = gpio_pin_configure_dt(&led, GPIO_OUTPUT_ACTIVE);
	if (ret < 0) {
		return 0;
	}

	while (1) {
		ret = gpio_pin_toggle_dt(&led);
		if (ret < 0) {
			return 0;
		}

		led_state = !led_state;
//		printf("LED state: %s\n", led_state ? "ON" : "OFF");
		k_msleep(SLEEP_TIME_MS);
	}
	return 0;
}
```
