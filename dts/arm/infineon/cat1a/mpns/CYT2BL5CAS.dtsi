/*
 * Copyright (c) 2026 Infineon Technologies AG,
 * or an affiliate of Infineon Technologies AG.
 *
 * SPDX-License-Identifier: Apache-2.0
 */

#include <arm/armv7-m.dtsi>
#include "cyt2bl.100-lqfp.dtsi"

&nvic {
	arm,num-irq-priority-bits = <3>;
};