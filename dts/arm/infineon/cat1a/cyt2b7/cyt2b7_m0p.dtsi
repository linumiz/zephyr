/*
 * Copyright (c) 2026 Infineon Technologies AG
 *
 * SPDX-License-Identifier: Apache-2.0
 */
#include <arm/armv6-m.dtsi>

/ {
	cpus {
		#address-cells = <1>;
		#size-cells = <0>;

		cpu@0 {
			compatible = "arm,cortex-m0+";
			reg = <0>;
			clock-frequency = <1000000000>;
		};
	};
};

&nvic {
	arm,num-irq-priority-bits = <2>;
};