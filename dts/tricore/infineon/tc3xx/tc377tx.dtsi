/*
 * Copyright (c) 2024 Infineon Technologies AG
 *
 * SPDX-License-Identifier: Apache-2.0
 */

#include <mem.h>
#include <infineon/tc3xx/tc37x_ext.dtsi>
#include <infineon/tc3xx/tc3x7_geth-pinctrl.dtsi>

/ {

};