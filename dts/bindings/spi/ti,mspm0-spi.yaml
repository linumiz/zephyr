## dts/bindings/spi/ti,mspm0-spi.yaml
```yaml
compatible: "ti,mspm0-spi"
include: [spi-controller.yaml, "pinctrl-device.yaml"]

properties:
  reg:
    required: true

  interrupts:
    required: true

  ti,clk-div:
    type: int
    default: 1
    enum:
      - 1
      - 2
      - 3
      - 4
      - 5
      - 6
      - 7
      - 8
    description: |
      Clock divider selction value.
```

## dts/bindings/timer/infineon,tcpwm.yaml
```yaml
# Copyright (c) 2025 Infineon Technologies AG,
# or an affiliate of Infineon Technologies AG.
#
# SPDX-License-Identifier: Apache-2.0

description: Infineon TCPWM Timer

compatible: "infineon,tcpwm"

include: [base.yaml, pinctrl-device.yaml]

properties:
  reg:
    type: array
    required: true
    description: Register base address and size information

  interrupts:
    type: array
    description: Interrupt mapping for TCPWM instance

  system-interrupts:
    type: array
    description: Required for cat1c devices

  pinctrl-0:
    description: |
      PORT pin configuration for SCL, SDA signals.
      We expect that the phandles will reference pinctrl nodes. These
      nodes will have a nodelabel that matches the Infineon SoC Pinctrl
      defines and have following
      format: p<port>_<pin>_<peripheral inst>_<signal>.

  divider-type:
    type: int
    description: |
      Specifies which type of divider to use.
      Defined by cy_en_divider_types_t in cy_sysclk.h.
    required: true

  divider-sel:
    type: int
    description: |
      Specifies which divider of the selected type to configure.
    required: true

  divider-val:
    type: int
    description: |
      Causes integer division of (divider value + 1), or division by 1 to 256
      (8-bit divider) or 1 to 65536 (16-bit divider).
    required: true

  ifx,peri-group:
    type: int
    required: true
    description: |
      Peripheral clock divider group. Use IFX_PERI_GRP_INST_SEL(grp, inst) macro.
      Required for cat1c devices

  resolution:
    type: int
    required: true
    description: Counter/timer resolution (16 or 32 bits)
    enum:
      - 16
      - 32
```

## dts/bindings/timer/nxp,imx-gpt.yaml
```yaml
# Copyright (c) 2018 Nordic Semiconductor ASA
# SPDX-License-Identifier: Apache-2.0

description: NXP MCUX General-Purpose Timer (GPT)

compatible: "nxp,imx-gpt"

include: base.yaml

properties:
  reg:
    required: true

  interrupts:
    required: true

  gptfreq:
    type: int
    required: true
    description: gpt frequencies

  disable-free-run:
    type: boolean
    description: Disable free-running mode (default: enabled). If set, GPT resets on compare.
```

## dts/bindings/usb/ti,bq25620-bc.yaml
```yaml
# Copyright (c) 2025, Linumiz GmbH
# SPDX-License-Identifier: Apache-2.0

description: Texas Instruments BQ2562X

compatible: "ti,bq25620-bc"

include: [usb-bc12.yaml]
```

## modules/Kconfig.jsonc
```kconfig
config JSONC
	bool "JSON-C support"
	help
	  This option enables the JSON-C library.
```

## modules/Kconfig.liblightmodbus
```kconfig
config LIBLIGHTMODBUS
	bool "liblightmodbus support"
	help
	  This option enables the liblightmodbus library.
```

## modules/Kconfig.libmodbus
```kconfig
config LIBMODBUS
	bool "libmodbus support"
	help
	  This option enables the libmodbus library.

config LIBMODBUS_RTU
	bool "libmodbus with RTU support"
	help
		RTU modbus

config LIBMODBUS_TCP
	bool "libmodbus with TCP support"
	help
		TCP modbus
```

## modules/Kconfig.libzio
```kconfig
config LIBZIO
	bool "libzio application library"
	help
	  This option enables the libzio library.
```

## modules/Kconfig.lz4
```kconfig
# Copyright (c) 2020 Linumiz
# SPDX-License-Identifier: Apache-2.0

config LZ4
	bool "Enable lz4 data compression and decompression"
	help
	  This option enabless the lz4 compression library support.
```

## modules/Kconfig.w5500
```kconfig
# Copyright (c) 2020 Linumiz
# SPDX-License-Identifier: Apache-2.0

config W5500
	bool "Enable W5500 IO library"
	help
	  This option enables W5500 IO library
```

## modules/canopennode/Kconfig
```kconfig
# Copyright (c) 2019 Vestas Wind Systems A/S
# Copyright (c) 2025 National Taiwan University Racing Team
# SPDX-License-Identifier: Apache-2.0

config ZEPHYR_CANOPENNODE_MODULE
	bool


menuconfig CANOPENNODE
	bool "CANopenNode support"
	depends on CAN && !CAN_FD_MODE
	select CRC
	select REBOOT
	help
	  Enables CANopenNode stack for CANopen protocol support.

if CANOPENNODE

config CANOPENNODE_INIT_PRIORITY
	int "Init priority"
	default 20
	help
	  CANopenNode initialization priority.

config CANOPENNODE_NODE_ID
	int "CANopen node ID"
	default 1
	range 1 127
	help
	  CANopen node ID of the device.

config CANOPENNODE_BITRATE
	int "CANopen bitrate in kHz"
	default 500
	help
	  CAN bus bitrate in kHz for CANopenNode.

config CANOPENNODE_MAINLINE_THREAD_STACK_SIZE
	int "Stack size for the CANopenNode mainline thread"
	default 2048
	help
	  Size of the stack used for the internal thread which
	  processes time consuming CANopenNode tasks.

config CANOPENNODE_MAINLINE_THREAD_PRIORITY
	int "Priority for CANopenNode mainline thread"
	default 5
	help
	  Priority level of the internal thread which processes
	  time consuming CANopenNode tasks.

config CANOPENNODE_MAINLINE_THREAD_PERIOD
	int "Period for the CANopenNode mainline thread"
	default 10000
	help
	  Period in microseconds for the internal thread which
	  processes time consuming CANopenNode tasks.

config CANOPENNODE_SYNC_THREAD_STACK_SIZE
	int "Stack size for the CANopenNode SYNC thread"
	default 1024
	help
	  Size of the stack used for the internal thread which
	  processes CANopen SYNC RPDOs and TPDOs.

config CANOPENNODE_SYNC_THREAD_PRIORITY
	int "Priority for CANopenNode SYNC thread"
	default 0 if !COOP_ENABLED
	default -5
	help
	  Priority level of the internal thread which processes
	  CANopen SYNC RPDOs and TPDOs.

config CANOPENNODE_SYNC_THREAD_PERIOD
	int "Period for the CANopenNode SYNC thread"
	default 1000
	help
	  Period in microseconds for the internal thread which
	  processes CANopen SYNC RPDOs and TPDOs.

config CANOPENNODE_NMT_STARTUP_TO_OPERATIONAL
	bool "NMT startup to operational"
	default y
	help
	  If enabled, device enters NMT operational state after
	  initialization phase, otherwise it enters
	  pre-operational state.

config CANOPENNODE_NMT_ERR_ON_BUSOFF_HB
	bool "NMT error on bus-off/heartbeat"
	help
	  If enabled, device enters pre-operational or stopped
	  state if CAN bus is off or heartbeat timeout is detected.

config CANOPENNODE_NMT_ERR_ON_ERR_REG_MASK
	hex "NMT error on non-zero masked error register"
	range 0x0 0xFF
	default 0x0
	help
	  If non-zero, device enters pre-operational or stopped
	  state if masked CANopen error register is non-zero.

config CANOPENNODE_NMT_ERR_TO_STOPPED
	bool "NMT error to stopped"
	help
	  If enabled, device enters stopped state if error
	  condition is met, otherwise it enters pre-operational
	  state.

config CANOPENNODE_NMT_ERR_FREE_TO_OPERATIONAL
	bool "NMT error free to operational"
	default y
	help
	  If enabled and device is pre-operational, it enters
	  operational state automatically if no error conditions
	  exist.

choice CANOPENNODE_HB_CONS
	prompt "CANopen heartbeat consumer support"
	default CANOPENNODE_HB_CONS_DISABLED
	help
	  Support for CANopen heartbeat consumer.

config CANOPENNODE_HB_CONS_DISABLED
	bool "Heartbeat consumer disabled"

config CANOPENNODE_HB_CONS_SINGLE_CALLBACK
	bool "Heartbeat consumer with a single callback"
	help
	  If enabled, heartbeat consumer will use a single callback
	  for all NMT state changes of the monitored node.

config CANOPENNODE_HB_CONS_MULTI_CALLBACK
	bool "Heartbeat consumer with multiple callbacks"
	help
	  If enabled, heartbeat consumer will use a separate callback
	  for each NMT state change of the monitored node.

endchoice

config CANOPENNODE_EM_ERR_STATUS_BITS_COUNT
	int "CANopen error status bits count"
	default 80
	range 48 256
	help
	  Number of error status bits in CANopenNode.

config CANOPENNODE_SDO_CLI
	bool "CANopen SDO client support"
	help
	  Enable support for CANopen SDO client.

config CANOPENNODE_SDO_BLOCK
	bool "CANopen SDO block transfer support"
	help
	  Enable support for CANopen SDO block transfer.

config CANOPENNODE_SDO_BUFFER_SIZE
	int "CANopen SDO buffer size"
	default 32 if !CANOPENNODE_SDO_BLOCK
	default 1000 if CANOPENNODE_SDO_BLOCK
	range 8 2147483647 if !CANOPENNODE_SDO_BLOCK
	range 899 2147483647  if CANOPENNODE_SDO_BLOCK
	help
	  Size of the internal CANopen SDO buffer in bytes.

config CANOPENNODE_SDO_TIMEOUT_TIME
	int "CANopen SDO timeout time in ms"
	default 1000

config CANOPENNODE_TIME
	bool "CANopen time object support"
	help
	  Enable support for CANopen time object.

choice CANOPENNODE_SYNC
	prompt "CANopen SYNC object support"
	default CANOPENNODE_SYNC_DISABLED
	help
	  Support for CANopen SYNC object.

config CANOPENNODE_SYNC_DISABLED
	bool "SYNC disabled"

config CANOPENNODE_SYNC_PRODUCER
	bool "SYNC producer"

config CANOPENNODE_SYNC_CONSUMER
	bool "SYNC consumer"

endchoice

config CANOPENNODE_PDO_SYNC
	bool "CANopen PDO SYNC support"
	depends on !CANOPENNODE_SYNC_DISABLED
	default y
	help
	  Enable support for SYNC in PDO.

config CANOPENNODE_STORAGE
	bool "CANopen object dictionary storage"
	depends on SETTINGS
	default y
	help
	  Enable support for storing the CANopen object dictionary to
	  non-volatile storage.

config CANOPENNODE_STORAGE_SUBTREE
	string "Settings subtree name for CANopen storage"
	depends on CANOPENNODE_STORAGE
	default "canopen"
	help
	  Settings subtree name for storing the CANopen object dictionary.

config CANOPENNODE_LEDS
	bool "CANopen LED indicators"
	default y
	select GPIO
	help
	  Enable support for CANopen LED indicators according to the CiA
	  303-3 specification.

config CANOPENNODE_LEDS_BICOLOR
	bool "CANopen bicolor LED indicator"
	depends on CANOPENNODE_LEDS
	help
	  Handle CANopen LEDs as one bicolor LED, favoring the red LED
	  over the green LED in accordance with the CiA 303-3
	  specification.

choice CANOPENNODE_LSS
	prompt "CANopen layer settings service (LSS) support"
	default CANOPENNODE_LSS_DISABLED
	help
	  Support for CANopen layer settings service (LSS) according to
	  the CiA 305 specification.

config CANOPENNODE_LSS_DISABLED
	bool "LSS disabled"

config CANOPENNODE_LSS_MASTER
	bool "LSS master"

config CANOPENNODE_LSS_SLAVE
	bool "LSS slave"

endchoice

config CANOPENNODE_PROGRAM_DOWNLOAD
	bool "CANopen program download"
	depends on BOOTLOADER_MCUBOOT
	select IMG_MANAGER
	default y
	help
	  Enable support for program download over CANopen according
	  to the CiA 302-3 (draft) specification.

endif # CANOPENNODE
```

## modules/lz4/Kconfig
```kconfig
# Copyright (c) 2020 Linumiz
# SPDX-License-Identifier: Apache-2.0

config ZEPHYR_LZ4_MODULE
	bool

config LZ4
	bool "Lz4 data compression and decompression"
	help
	  This option enables lz4 compression & decompression library
	  support.

if LZ4
config LZ4_AUTO_FRAME
	bool "Lz4 auto-frame library support"
	help
	  This option enables lz4 auto-frame library support.

config LZ4_HC
	bool "Lz4 high compression mode support"
	help
	  This option enables lz4 high compression mode support.
endif
```

## soc/ambiq/apollo2x/Kconfig.defconfig
```kconfig
# SPDX-License-Identifier: Apache-2.0
#
# Copyright (c) 2025 Linumiz GmbH
# Author : Sri Surya  <srisurya@linumiz.com>

if SOC_APOLLO2

config NUM_IRQS
	default 32

endif
```

## soc/infineon/aurix/Kconfig.soc
```kconfig
# Copyright 2024 Infineon Technologies AG
# SPDX-License-Identifier: Apache-2.0


config SOC_FAMILY_AURIX
	bool

config SOC_SERIES_TC3XX
	bool
	help
	  Enable support for TC3XX MCU series

config SOC_SERIES_TC4XX
	bool
	help
	  Enable support for TC4XX MCU series

config SOC_FAMILY
	default "aurix" if SOC_FAMILY_AURIX

rsource "*/Kconfig.soc"
```

## soc/infineon/aurix/tc3xx/Kconfig
```kconfig
# Copyright (c) 2024 Infineon Technologies AG
# SPDX-License-Identifier: Apache-2.0

config SOC_SERIES_TC3XX
	select TRICORE
	select CPU_TC162
	select CPU_HAS_FPU
	select CPU_HAS_MPU
	select TC_IR
	select HAS_INFINEON_TC3XX_HAL
```

## soc/infineon/aurix/tc3xx/Kconfig.defconfig
```kconfig
if SOC_SERIES_TC3XX

config NUM_IRQS
    default 1024

config AURIX_CORE_TOS
	default 0 if TRICORE_CORE_ID = 0
	default 2 if TRICORE_CORE_ID = 1
	default 3 if TRICORE_CORE_ID = 2
	default 4 if TRICORE_CORE_ID = 3
	default 5 if TRICORE_CORE_ID = 4
	default 6 if TRICORE_CORE_ID = 5

config AURIX_NEXT_CORE_START_ADDRESS
	hex "Start address for the next core to start"
	default 0x80300000 if (AURIX_NEXT_CORE=1)
	default 0x80480000 if (AURIX_NEXT_CORE=2 && (SOC_TC375TP || SOC_TC377TX))
	default 0x80600000 if (AURIX_NEXT_CORE=2 && !(SOC_TC375TP || SOC_TC377TX))
	default 0x80900000 if (AURIX_NEXT_CORE=3)
	default 0x80C00000 if (AURIX_NEXT_CORE=4)
	default 0x80F00000 if (AURIX_NEXT_CORE=5)
	default 0

#config ETH_DWC_ETHER_QOS_DMA_PER_CH_IRQ
#	default y

config TRICORE_MPU_CODE_REGIONS
	default 10

config TRICORE_MPU_DATA_REGIONS
	default 18

config TRICORE_MPU_PROTECTION_SETS
	default 6

endif
```

## soc/infineon/aurix/tc3xx/Kconfig.soc
```kconfig
# Copyright (c) 2024 Infineon Technologies AG
# SPDX-License-Identifier: Apache-2.0

# Infineon Aurix 2nd Generation Devices

config SOC_SERIES_TC3XX
	select SOC_FAMILY_AURIX
	help
	  Enable support for TC3XX MCU series

config SOC_SERIES
    default "tc3xx" if SOC_SERIES_TC3XX

config SOC_TC37A
	bool
	select SOC_SERIES_TC3XX

config SOC_TC37AED
	bool
	select SOC_SERIES_TC3XX

config SOC_TC38A
	bool
	select SOC_SERIES_TC3XX

config SOC_TC39B
	bool
	select SOC_SERIES_TC3XX

config SOC_TC375TP
	bool
	select SOC_TC37A

config SOC_TC377TX
	bool
	select SOC_TC37AED

config SOC_TC387QP
	bool
	select SOC_TC38A
	
config SOC_TC397XP 
	bool
	select SOC_TC39B

config SOC
	default "tc375tp" if SOC_TC375TP
	default "tc377tx" if SOC_TC377TX
	default "tc387qp" if SOC_TC3787QP
	default "tc397xp" if SOC_TC397XP
```

## soc/infineon/aurix/tc4xx/Kconfig
```kconfig
# Copyright (c) 2024 Infineon Technologies AG
# SPDX-License-Identifier: Apache-2.0

config SOC_SERIES_TC4XX
	select TRICORE
	select CPU_TC18
	select CPU_HAS_FPU if SOC_TC4XX_CORECPU
	select CPU_HAS_FPU_DOUBLE_PRECISION if SOC_TC4XX_CORECPU
	select CPU_HAS_TRICORE_VIRTUALIZATION if SOC_TC4XX_CORECPU
	select CPU_HAS_MPU
	select TC_IR
	select HAS_INFINEON_TC4XX_HAL

config SOC_TC4XX_CSCPU
	bool
	default y if TRICORE_CORE_ID = 6
	default n

config SOC_TC4XX_CORECPU
	bool
	default y if TRICORE_CORE_ID < 6
	default n
```

## soc/infineon/aurix/tc4xx/Kconfig.defconfig
```kconfig
if SOC_SERIES_TC4XX

config NUM_IRQS
    default 2048

config AURIX_CORE_TOS
	default 0 if TRICORE_CORE_ID = 0
	default 1 if TRICORE_CORE_ID = 1
	default 2 if TRICORE_CORE_ID = 2
	default 3 if TRICORE_CORE_ID = 3
	default 4 if TRICORE_CORE_ID = 4
	default 5 if TRICORE_CORE_ID = 5
	default 6 if TRICORE_CORE_ID = 6

config AURIX_NEXT_CORE_START_ADDRESS
	default 0x80400000 if (AURIX_NEXT_CORE_ID=1)
	default 0x80800000 if (AURIX_NEXT_CORE_ID=2)
	default 0x80A00000 if (AURIX_NEXT_CORE_ID=3)
	default 0x80E00000 if (AURIX_NEXT_CORE_ID=4)
	default 0x81200000 if (AURIX_NEXT_CORE_ID=5)
	default 0

#config ETH_DWC_ETHER_XGMAC_DMA_PER_CH_IRQ
#	default y

#config ETH_DWC_ETHER_QOS_DMA_PER_CH_IRQ
#	default y

config TRICORE_MPU_CODE_REGIONS
	default 16

config TRICORE_MPU_DATA_REGIONS
	default 24

config TRICORE_MPU_PROTECTION_SETS
	default 8
endif
```

## soc/infineon/aurix/tc4xx/Kconfig.soc
```kconfig
# Copyright (c) 2024 Infineon Technologies AG
# SPDX-License-Identifier: Apache-2.0

# Infineon Aurix 3nd Generation Devices

config SOC_SERIES_TC4XX
	select SOC_FAMILY_AURIX
	help
	  Enable support for TC4XX MCU series

config SOC_SERIES
    default "tc4xx" if SOC_SERIES_TC4XX

config SOC_TC4DA
	bool
	select SOC_SERIES_TC4XX

config SOC_TC4D7XP
	bool
	select SOC_TC4DA

config SOC_TC4D9XP
	bool
	select SOC_TC4DA

config SOC
	default "tc4d7xp" if SOC_TC4D7XP
	default "tc4d9xp" if SOC_TC4D9XP
```
