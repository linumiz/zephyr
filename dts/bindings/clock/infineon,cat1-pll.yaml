## dts/bindings/clock/infineon,cat1-pll.yaml
```yaml
# Copyright (c) 2025 Linumiz GmbH 
#
# SPDX-License-Identifier: Apache-2.0

description: Infineon CAT1C PLL Driver

compatible: "infineon,cat1-pll"

include: [base.yaml, clock-controller.yaml]

properties:
  clocks:
    required: true
    description: |
      Clock reference source

  ifx,pll-instance:
    type: int
    description: PLL instance of pll node 
    required: true

  p-div:
    type: int
    required: true
    description: |
      pdiv is the feedback-divider of the output.

  q-div:
    type: int
    required: true
    description: |
      qdiv functions as a refernce-divider value.

  output-div:
    type: int
    description: |
      Output Divider of the pll clock out.

  "#clock-cells":
    const: 0
```

## dts/bindings/clock/infineon,peri-clock.yaml
```yaml
# Copyright (c) 2026 Linumiz
#
# SPDX-License-Identifier: Apache-2.0

description: Infineon Peripheral Clock Driver 

compatible: "infineon,peri-clock"

include: [base.yaml, clock-controller.yaml]

properties:
  clocks:
    description: |
      Clock reference source

  ifx,8-bit-max-divider:
    type: int
    description: Maximum number of 8-bit dividers in peri group 
    required: true

  ifx,16-bit-max-divider: 
    type: int
    description: Maximum number of 16-bit dividers in peri group 
    required: true

  ifx,16-5-bit-max-divider:
    type: int
    description: Maximum number of 16.5-bit dividers in peri group 
    required: true

  ifx,24-5-bit-max-divider:
    type: int
    description: Maximum number of 24.5-bit dividers in peri group 
    required: true

  ifx,peri-clk-inst:
    type: int
    description: peripheral clock divider instance
    required: true

  "#clock-cells":
    const: 3

clock-cells:
  - root-clk-id
  - divider-type
  - divider-inst
```

## dts/bindings/dac/ti,mspm0-dac.yaml
```yaml
# Copyright (c) 2025 Linumiz GmbH
# SPDX-License-Identifier: Apache-2.0

description: |
   Texas Instruments MSPM0 G-Series Digital-to-Analog Converter (DAC).

compatible: "ti,mspm0-dac"

include: base.yaml

properties:
  reg:
    required: true

  interrupts:
    required: true
```

## dts/bindings/flash_controller/infineon,cat1-flash-controller-pdl.yaml
```yaml
description: Infineon CAT1 flash controller PDL driver

compatible: "infineon,cat1-flash-controller-pdl"

include: flash-controller.yaml
```

## dts/bindings/flash_controller/infineon,serial-memory-qspi.yaml
```yaml
# Copyright (c) 2025 Infineon Technologies AG,
# or an affiliate of Infineon Technologies AG.
#
# SPDX-License-Identifier: Apache-2.0

description: Infineon Serial Memory based QSPI flash controller

compatible: "infineon,serial-memory-qspi"

include: [flash-controller.yaml, pinctrl-device.yaml]

properties:
  pinctrl-0:
    description: |
      PORT pin configuration for the SMIF/QSPI signals.
      We expect that the phandles will reference pinctrl nodes. These
      nodes will have a nodelabel that matches the Infineon SoC pinctrl
      defines and have the following format:
        p<port>_<pin>_smif<inst>_<signal>.

      Examples:
        pinctrl-0 = <&p23_0_smif0_data4 &p24_1_smif0_clk>;
    required: true

  pinctrl-names:
    description: Name of the pinctrl state used by the SMIF/QSPI controller.
    required: true
```

## dts/bindings/fuel-gauge/ht,hy4245.yaml
```yaml
# Copyright (c) 2025, Linumiz
#
# SPDX-License-Identifier: Apache-2.0

description: |
  Hycon Technology HY4245 fuel gauge.

compatible: "ht,hy4245"

include: [i2c-device.yaml, fuel-gauge.yaml]
```

## dts/bindings/gpio/infineon,tc4xx-gpio.yaml
```yaml
# Copyright (c) 2024 Infineon Technologies AG
# SPDX-License-Identifier: Apache-2.0

description: Infineon TC4xx Port Module

compatible: "infineon,tc4xx-gpio"

include: [gpio-controller.yaml, base.yaml]

properties:
  reg:
    required: true

  irq-sources:
    type: array

  "#gpio-cells":
    const: 2

gpio-cells:
  - pin
  - flags
```

## dts/bindings/i2c/infineon,cat1-i2c-pdl.yaml
```yaml
# Copyright (c) 2025 Infineon Technologies AG,
# or an affiliate of Infineon Technologies AG.
#
# SPDX-License-Identifier: Apache-2.0

description: |
  Infineon CAT1 PDL-based I2C driver

  This driver configures the SCB as an I2C device.

  Example devicetree configuration with vl53l0x Time-of-Flight (ToF)
  ranging sensor connected on the bus:

  i2c3: &scb3 {
      compatible = "infineon,cat1-i2c-pdl";
      status = "okay";

      #address-cells = <1>;
      #size-cells = <0>;

      pinctrl-0 = <&p6_0_scb3_i2c_scl &p6_1_scb3_i2c_sda>;
      pinctrl-names = "default";

      vl53l0x@29 {
        compatible = "st,vl53l0x";
        reg = <0x29>;
      };
  };

  The pinctrl nodes need to be configured as open-drain and
  input-enable:

  &p6_0_scb3_i2c_scl {
    drive-open-drain;
    input-enable;
  };

  &p6_1_scb3_i2c_sda {
    drive-open-drain;
    input-enable;
  };

compatible: "infineon,cat1-i2c-pdl"

include: [i2c-controller.yaml, pinctrl-device.yaml, "infineon,cat1-scb.yaml"]

properties:
  reg:
    type: array
    required: true

  system-interrupts:
    type: array
    required: true

  pinctrl-0:
    description: |
      PORT pin configuration for SCL, SDA signals.
      We expect that the phandles will reference pinctrl nodes. These
      nodes will have a nodelabel that matches the Infineon SoC Pinctrl
      defines and have following
      format: p<port>_<pin>_<peripheral inst>_<signal>.

      Examples:
        pinctrl-0 = <&p6_0_scb3_i2c_scl &p6_1_scb3_i2c_sda>;
    required: true

  pinctrl-names:
    required: true

  clock-frequency:
    type: int
    description: |
      Frequency that the I2C bus runs

  ifx,peri-clk:
    type: int
    description:
      Clock selection for peripheral

  ifx,peri-group:
    type: int
    description:
      Peripheral clock divider group and inst for scb i2c

  ifx,peri-div:
    type: int
    required: true
    enum:
      - 0 # 8-bit divider
      - 1 # 16-bit divider
      - 2 # 16_5-bit divider
      - 3 # 24_5-bit divider
    description:
      Peripheral clock divider type.

  ifx,peri-div-inst:
    type: int
    required: true
    description:
      Peripheral clock divider type instance. peripheral clock divider has
      multiple instnace of same type divider, so this property is used to specifi
      which instance to be used. please refer device specific datasheet for
      number of instance present for every divider type.
```

## dts/bindings/i2c/ti,mspm0-i2c.yaml
```yaml
# SPDX-License-Identifier: Apache-2.0
# Copyright (c) 2024 Texas Instruments
# Copyright (c) 2024 Linumiz

description: TI MSPM0 I2C

compatible: "ti,mspm0-i2c"

include: [i2c-controller.yaml, pinctrl-device.yaml, base.yaml]

properties:
  reg:
    required: true

  interrupts:
    required: true

  pinctrl-0:
    required: true

  pinctrl-names:
    required: true
```

## dts/bindings/mbox/infineon,cat1-mbox-pdl.yaml
```yaml
# Copyright (c) 2025 Linumiz GmbH
#
# SPDX-License-Identifier: Apache-2.0

description: |
  Infineon IPC Unit as Zephyr MBOX.

  This Infineon Mailbox driver implements Multi-Channel Inter-Processor Mailbox (MBOX) API
  around Infineon Inter-processor communication IP block.

compatible: "infineon,cat1-mbox-pdl"

include: [base.yaml, mailbox-controller.yaml, "infineon,system-interrupts.yaml"]

properties:
  reg:
    type: array
    required: true

  system-interrupts:
    required: true

mbox-cells:
  - channel
```

## dts/bindings/mfd/ti,bq2652x.yaml
```yaml
# Copyright 2025 Linumiz GmbH
# SPDX-License-Identifier: Apache-2.0

description: |
  BQ25620/BQ25622 is a single cell buck battery charger with OTG support.

  The device has a single child node for the charger. For example:

  bq25620@6b {
    compatible = "ti,bq2562x";
    reg = <0x6b>;
    int-gpio = <&gpio0 18 GPIO_ACTIVE_LOW>;
  };

compatible: "ti,bq2562x"

include: [i2c-device.yaml]

properties:
  int-gpios:
    type: phandle-array
    description: Interrupt pin
```

## dts/bindings/modem/simcom,7080.yaml
```yaml
# Copyright (C) 2023 Linumiz
# Copyright (C) 2023 Linumiz
# SPDX-License-Identifier: Apache-2.0

description: Simcom modem 7080 series

include: uart-device.yaml

properties:
  mdm-power-gpios:
    type: phandle-array
    required: true
```

## dts/bindings/modem/simcom,sim7080.yaml
```yaml
# Copyright (C) 2021 metraTec GmbH
# Copyright (C) 2023 Linumiz
# SPDX-License-Identifier: Apache-2.0

description: Simcom SIM7080 Modem

compatible: "simcom,sim7080"

include: simcom,7080.yaml
```

## dts/bindings/modem/simcom,y7080.yaml
```yaml
# Copyright (C) 2023 Linumiz
# SPDX-License-Identifier: Apache-2.0

description: Simcom Y7080 Modem

compatible: "simcom,y7080"

include: simcom,7080.yaml
```

## dts/bindings/modem/simcom.yaml
```yaml
# Copyright (C) 2023 Linumiz
# SPDX-License-Identifier: Apache-2.0

description: Simcom modem 7080 series

compatible: "simcom,7080"

include: uart-device.yaml

properties:
  mdm-power-gpios:
    type: phandle-array
    required: true
```

## dts/bindings/regulator/mp5416.yaml
```yaml
description: |
  MPS MP5416 PMIC

  The PMIC has four buck regulators and five LDOs.
  Control is available via I2C. Regulator control includes voltage setting,
  enabling/disabling, discharge configuration, and soft start delays.

  Example:

  pmic@69 {
    compatible = "mps,mp5416";
    reg = <0x69>;
    ...
    BUCK1 {
      /* all properties for BUCK1 */
    };
    BUCK2 {
      /* all properties for BUCK2 */
    };
    BUCK3 {
      /* all properties for BUCK3 */
    };
    BUCK4 {
      /* all properties for BUCK4 */
    };
    LDO1 {
      /* all properties for LDO1 */
    };
    LDO2 {
      /* all properties for LDO2 */
    };
    LDO3 {
      /* all properties for LDO3 */
    };
    LDO4 {
      /* all properties for LDO4 */
    };
    LDO5 {
      /* all properties for LDO5 */
    };
  };

compatible: "mps,mp5416"

include: [i2c-device.yaml, regulator.yaml]

child-binding:
  description: |
    Regulator node for each output rail of MP5416 (BUCK1–4, LDO1–5)

  include:
    - name: regulator.yaml
      property-allowlist:
        - regulator-name
        - regulator-min-microvolt
        - regulator-max-microvolt
        - regulator-init-microvolt
        - regulator-boot-on
        - regulator-always-on
        - regulator-active-discharge
        - regulator-enable-ramp-delay
        - regulator-disable-ramp-delay

  properties:
    enable-inverted:
      type: boolean
      description: |
        If the enable bit must be cleared to turn on the regulator, add this flag.

    mps,ilim-microamp:
      type: int
      description: |
        Optional current limit in microamps for buck regulators (ignored for LDOs).
        Supported values may vary per BUCK (refer to datasheet).

    mps,dvs-slew-rate:
      type: int
      enum: [32000, 16000, 8000, 4000]
      description: |
        Slew rate for dynamic voltage scaling on BUCKs (in uV/us).
        Ignored for LDOs.
```

## dts/bindings/rng/ti,mspm0-trng.yaml
```yaml
description: |
  Texas Instruments MSPM0 Series True Random Number Generator (TRNG).
  This peripheral provides a hardware-based source of entropy with built-in
  health monitoring.

compatible: "ti,mspm0-trng"

include: base.yaml
properties:
  reg:
    type: array
    description: MMIO register space
    required: true

  interrupts:
    type: array
    description: |
      Interrupt specification. For MSPM0, this requires two cells.
      The first cell is the NVIC IRQ line (17 for INT_GROUP1).
      The second cell is the interrupt priority (0-3, where 0 is highest).
    required: true
```

## dts/bindings/sensor/cirrus,cs5490.yaml
```yaml
# Copyright (c) 2024 Linumiz
# SPDX-License-Identifier: Apache-2.0

description: Cirrus CS5490 Two Channel Energy Measurement sensor.

compatible: "cirrus,cs5490"

include: [sensor-device.yaml, uart-device.yaml]

properties:
  reg:
    required: true
  int-gpios:
    type: phandle-array
    required: true
    description: |
      This property specifies the connection for INT, this pin
      defaults to active low when sample produce interrupt.

  reset-gpios:
    type: phandle-array
    description: |
      This property used to specifies reset pin from sensor to
      microcontroller and active low to reset sensor.
```

## dts/bindings/sensor/st,ais2dw12-common.yaml
```yaml
# Copyright (c) 2024 Linumiz
# SPDX-License-Identifier: Apache-2.0

description: |
    When setting the odr, power-mode, and range properties in a .dts or .dtsi
    file you may include st_AIS2DW12.h and use the macros defined there.
    AIS2DW12: AIS2DW12@0 {
      ...
    };

include: sensor-device.yaml

properties:
  int-gpios:
    type: phandle-array
    description: |
      INT pin

      This pin defaults to active high when produced by the sensor.
      The property value should ensure the flags properly describe
      the signal that is presented to the driver.

  int-cfg:
    type: int
    enum: [1, 2]
    default: 1
    description: |
      This property is used for interrupt routing.The sensor
      has two interrupt pins.By default the interrupt are routed
      to interrupt pin 1, if the value is 2, then all th interrupt
      routed to interrupt pin 2.
```

## dts/bindings/sensor/st,ais2dw12-i2c.yaml
```yaml
# Copyright (c) 2024 Linumiz
# SPDX-License-Identifier: Apache-2.0

description: STMicroelectronics AIS2DW12 3-axis accelerometer

compatible: "st,ais2dw12"

include: ["i2c-device.yaml", "st,ais2dw12-common.yaml"]
```

## dts/bindings/sensor/st,ais2dw12-spi.yaml
```yaml
# Copyright (c) 2024 Linumiz
# SPDX-License-Identifier: Apache-2.0

description: |
    STMicroelectronics AIS2DW12 3-axis accelerometer accessed through SPI bus

compatible: "st,ais2dw12"

include: ["spi-device.yaml", "st,ais2dw12-common.yaml"]
```

## dts/bindings/sensor/te,htu21d.yaml
```yaml
#
# Copyright (c) 2022 Linumiz
#
# SPDX-License-Identifier: Apache-2.0
#
description: htu21d temperature and humidity sensor.

compatible: "te,htu21d"

include: i2c-device.yaml
```

## dts/bindings/sensor/ti,bq34110.yaml
```yaml
#
# Copyright (c) 2020 Linumiz
#
# SPDX-License-Identifier: Apache-2.0
#

description: Texas Instruments BQ34110 Fuel Gauge

compatible: "ti,bq34110"

include: i2c-device.yaml

properties:
    design-voltage:
      type: int
      required: true
      description: Battery Design Voltage in mV

    design-capacity:
      type: int
      required: true
      description: Battery Design Capacity in mAh

    taper-current:
      type: int
      required: true
      description: Battery Taper Current in mAh

    taper-voltage:
      type: int
      required: true
      description: Battery Taper Voltage in mV

    no-of-series-cells:
      type: int
      required: true
      description: No of Serial Cells Connected.
```

## dts/bindings/serial/infineon,cat1-uart-pdl.yaml
```yaml
# Copyright (c) 2025 Cypress Semiconductor Corporation (an Infineon company) or
# an affiliate of Cypress Semiconductor Corporation
#
# SPDX-License-Identifier: Apache-2.0

description: Infineon CAT1 UART

compatible: "infineon,cat1-uart-pdl"

include: infineon,cat1-uart.yaml

properties:
  clocks:
    required: true
    description:
      Clock source for uart block.
```
